#include <dt-bindings/clock/mt6763-clk.h>
#include <dt-bindings/interrupt-controller/arm-gic.h>
#include <dt-bindings/interrupt-controller/irq.h>
#include <dt-bindings/mmc/mt6763-msdc.h>
/* mt6763-pinfunc.h will be removed after DCT auto gen check-in */
#include <dt-bindings/pinctrl/mt6763-pinfunc.h>
#include <generated/autoconf.h>
#include <dt-bindings/memory/mt6763-larb-port.h>
#ifdef CONFIG_MTK_DTBO_FEATURE
/dts-v1/;
#endif

/ {
	model = "mt6763";
	compatible = "mediatek,mt6763";
	interrupt-parent = <0x1>;
	#address-cells = <0x2>;
	#size-cells = <0x2>;

	chosen {
		bootargs = "console=tty0 console=ttyMT3,921600n1 vmalloc=496M slub_max_order=0 slub_debug=OFZPU androidboot.hardware=mt6763 maxcpus=8 firmware_class.path=/vendor/firmware loop.max_part=7";
		linux,phandle = <0x4c>;
		phandle = <0x4c>;
	};

	chipid@08000000 {
		compatible = "mediatek,chipid";
		reg = <0x0 0x8000000 0x0 0x4 0x0 0x8000004 0x0 0x4 0x0 0x8000008 0x0 0x4 0x0 0x800000c 0x0 0x4>;
	};

	pmu {
		compatible = "arm,armv8-pmuv3";
		interrupts = <0x1 0x7 0x8>;
	};

	msdc@11230000 {
		compatible = "mediatek,msdc";
		reg = <0x0 0x11230000 0x0 0x10000>;
		interrupts = <0x0 0x4f 0x8>;
		index = [00];
		clk_src = [01];
		bus-width = <0x8>;
		max-frequency = <0xbebc200>;
		cap-mmc-highspeed;
		msdc-sys-suspend;
		mmc-ddr-1_8v;
		mmc-hs200-1_8v;
		mmc-hs400-1_8v;
		non-removable;
		pinctl = <0x2>;
		register_setting = <0x3>;
		host_function = [00];
		bootable;
		status = "disable";
		vmmc-supply = <0x4>;
		clocks = <0x5 0x20 0x5 0x1d>;
		clock-names = "msdc0-clock", "msdc0-hclock";
		hw_dvfs = [00];
		linux,phandle = <0x3d>;
		phandle = <0x3d>;
	};

	msdc@11240000 {
		compatible = "mediatek,msdc";
		reg = <0x0 0x11240000 0x0 0x10000>;
		interrupts = <0x0 0x50 0x8>;
		index = [01];
		clk_src = [04];
		bus-width = <0x4>;
		max-frequency = <0xbebc200>;
		msdc-sys-suspend;
		cap-sd-highspeed;
		sd-uhs-sdr12;
		sd-uhs-sdr25;
		sd-uhs-sdr50;
		sd-uhs-sdr104;
		sd-uhs-ddr50;
		pinctl = <0x6>;
		pinctl_sdr104 = <0x7>;
		pinctl_sdr50 = <0x8>;
		pinctl_ddr50 = <0x9>;
		register_setting = <0xa>;
		host_function = [01];
		cd_level = [01];
		cd-gpios = <0xb 0x3 0x0>;
		status = "okay";
		vmmc-supply = <0xc>;
		vqmmc-supply = <0xd>;
		clocks = <0x5 0x29 0x5 0x1e>;
		clock-names = "msdc1-clock", "msdc1-hclock";
		hw_dvfs = [00];
		linux,phandle = <0x4d>;
		phandle = <0x4d>;
	};

	msdc@11250000 {
		compatible = "mediatek,msdc";
		reg = <0x0 0x11250000 0x0 0x10000>;
		interrupts = <0x0 0x51 0x8>;
		index = [02];
		clk_src = [04];
		bus-width = <0x4>;
		max-frequency = <0xbebc200>;
		cap-sd-highspeed;
		sd-uhs-sdr12;
		sd-uhs-sdr25;
		sd-uhs-sdr50;
		sd-uhs-sdr104;
		sd-uhs-ddr50;
		keep-power-in-suspend;
		non-removable;
		pinctl = <0xe>;
		register_setting = <0xf>;
		host_function = [02];
		status = "disable";
		clocks = <0x5 0x2a 0x5 0x1f>;
		clock-names = "msdc2-clock", "msdc2-hclock";
		hw_dvfs = [00];
		linux,phandle = <0x4e>;
		phandle = <0x4e>;
	};

	msdc1_ins@0 {
		compatible = "mediatek,mt6763-sdcard-ins";
		linux,phandle = <0x4f>;
		phandle = <0x4f>;
	};

	msdc0_top@11f50000 {
		compatible = "mediatek,msdc0_top";
		reg = <0x0 0x11f50000 0x0 0x1000>;
	};

	msdc1_top@11e10000 {
		compatible = "mediatek,msdc1_top";
		reg = <0x0 0x11e10000 0x0 0x1000>;
	};

	mobicore {
		compatible = "trustonic,mobicore";
		interrupts = <0x0 0x124 0x1>;
	};

	psci {
		compatible = "arm,psci-0.2";
		method = "smc";
		cpu_suspend = <0x84000001>;
		cpu_off = <0x84000002>;
		cpu_on = <0x84000003>;
		affinity_info = <0x84000004>;
	};

	atf_logger {
		compatible = "mediatek,atf_logger";
		interrupts = <0x0 0x7b 0x1>;
	};

	utos {
		compatible = "microtrust,utos";
		interrupts = <0x0 0x110 0x1 0x0 0x111 0x1>;
	};

	utos_tester {
		compatible = "microtrust,tester-v1";
	};

	cpus {
		#address-cells = <0x1>;
		#size-cells = <0x0>;

		cpu@000 {
			device_type = "cpu";
			compatible = "arm,cortex-a53";
			reg = <0x0>;
			enable-method = "psci";
			cpu-idle-states = <0x10 0x11 0x12 0x13 0x14 0x15 0x16 0x17 0x18 0x19 0x1a>;
			cpu-release-addr = <0x0 0x40000200>;
			clock-frequency = <0x61a1e580>;
			linux,phandle = <0x1b>;
			phandle = <0x1b>;
		};

		cpu@001 {
			device_type = "cpu";
			compatible = "arm,cortex-a53";
			reg = <0x1>;
			enable-method = "psci";
			cpu-idle-states = <0x10 0x11 0x12 0x13 0x14 0x15 0x16 0x17 0x18 0x19 0x1a>;
			cpu-release-addr = <0x0 0x40000200>;
			clock-frequency = <0x61a1e580>;
			linux,phandle = <0x1c>;
			phandle = <0x1c>;
		};

		cpu@002 {
			device_type = "cpu";
			compatible = "arm,cortex-a53";
			reg = <0x2>;
			enable-method = "psci";
			cpu-idle-states = <0x10 0x11 0x12 0x13 0x14 0x15 0x16 0x17 0x18 0x19 0x1a>;
			cpu-release-addr = <0x0 0x40000200>;
			clock-frequency = <0x61a1e580>;
			linux,phandle = <0x1d>;
			phandle = <0x1d>;
		};

		cpu@003 {
			device_type = "cpu";
			compatible = "arm,cortex-a53";
			reg = <0x3>;
			enable-method = "psci";
			cpu-idle-states = <0x10 0x11 0x12 0x13 0x14 0x15 0x16 0x17 0x18 0x19 0x1a>;
			cpu-release-addr = <0x0 0x40000200>;
			clock-frequency = <0x61a1e580>;
			linux,phandle = <0x1e>;
			phandle = <0x1e>;
		};

		cpu@100 {
			device_type = "cpu";
			compatible = "arm,cortex-a53";
			reg = <0x100>;
			enable-method = "psci";
			cpu-idle-states = <0x10 0x11 0x12 0x13 0x14 0x15 0x16 0x17 0x18 0x19 0x1a>;
			cpu-release-addr = <0x0 0x40000200>;
			clock-frequency = <0x8b799100>;
			linux,phandle = <0x1f>;
			phandle = <0x1f>;
		};

		cpu@101 {
			device_type = "cpu";
			compatible = "arm,cortex-a53";
			reg = <0x101>;
			enable-method = "psci";
			cpu-idle-states = <0x10 0x11 0x12 0x13 0x14 0x15 0x16 0x17 0x18 0x19 0x1a>;
			cpu-release-addr = <0x0 0x40000200>;
			clock-frequency = <0x8b799100>;
			linux,phandle = <0x20>;
			phandle = <0x20>;
		};

		cpu@102 {
			device_type = "cpu";
			compatible = "arm,cortex-a53";
			reg = <0x102>;
			enable-method = "psci";
			cpu-idle-states = <0x10 0x11 0x12 0x13 0x14 0x15 0x16 0x17 0x18 0x19 0x1a>;
			cpu-release-addr = <0x0 0x40000200>;
			clock-frequency = <0x8b799100>;
			linux,phandle = <0x21>;
			phandle = <0x21>;
		};

		cpu@103 {
			device_type = "cpu";
			compatible = "arm,cortex-a53";
			reg = <0x103>;
			enable-method = "psci";
			cpu-idle-states = <0x10 0x11 0x12 0x13 0x14 0x15 0x16 0x17 0x18 0x19 0x1a>;
			cpu-release-addr = <0x0 0x40000200>;
			clock-frequency = <0x8b799100>;
			linux,phandle = <0x22>;
			phandle = <0x22>;
		};

		cpu-map {

			cluster0 {

				core0 {
					cpu = <0x1b>;
				};

				core1 {
					cpu = <0x1c>;
				};

				core2 {
					cpu = <0x1d>;
				};

				core3 {
					cpu = <0x1e>;
				};
			};

			cluster1 {

				core0 {
					cpu = <0x1f>;
				};

				core1 {
					cpu = <0x20>;
				};

				core2 {
					cpu = <0x21>;
				};

				core3 {
					cpu = <0x22>;
				};
			};
		};

		idle-states {
			entry-method = "arm,psci";

			legacy-mcdi {
				compatible = "arm,idle-state";
				arm,psci-suspend-param = <0x1>;
				entry-latency-us = <0x258>;
				exit-latency-us = <0x258>;
				min-residency-us = <0x4b0>;
				linux,phandle = <0x10>;
				phandle = <0x10>;
			};

			legacy-sodi {
				compatible = "arm,idle-state";
				arm,psci-suspend-param = <0x2>;
				entry-latency-us = <0x258>;
				exit-latency-us = <0x258>;
				min-residency-us = <0x4b0>;
				linux,phandle = <0x11>;
				phandle = <0x11>;
			};

			legacy-sodi3 {
				compatible = "arm,idle-state";
				arm,psci-suspend-param = <0x3>;
				entry-latency-us = <0x258>;
				exit-latency-us = <0x258>;
				min-residency-us = <0x4b0>;
				linux,phandle = <0x12>;
				phandle = <0x12>;
			};

			legacy-dpidle {
				compatible = "arm,idle-state";
				arm,psci-suspend-param = <0x4>;
				entry-latency-us = <0x258>;
				exit-latency-us = <0x258>;
				min-residency-us = <0x4b0>;
				linux,phandle = <0x13>;
				phandle = <0x13>;
			};

			legacy-suspend {
				compatible = "arm,idle-state";
				arm,psci-suspend-param = <0x5>;
				entry-latency-us = <0x258>;
				exit-latency-us = <0x258>;
				min-residency-us = <0x4b0>;
				linux,phandle = <0x14>;
				phandle = <0x14>;
			};

			mcdi-cpu {
				compatible = "arm,idle-state";
				arm,psci-suspend-param = <0x10001>;
				entry-latency-us = <0x258>;
				exit-latency-us = <0x258>;
				min-residency-us = <0x4b0>;
				linux,phandle = <0x15>;
				phandle = <0x15>;
			};

			mcdi-cluster {
				compatible = "arm,idle-state";
				arm,psci-suspend-param = <0x1010001>;
				entry-latency-us = <0x258>;
				exit-latency-us = <0x258>;
				min-residency-us = <0x4b0>;
				linux,phandle = <0x16>;
				phandle = <0x16>;
			};

			sodi {
				compatible = "arm,idle-state";
				arm,psci-suspend-param = <0x1010002>;
				entry-latency-us = <0x320>;
				exit-latency-us = <0x3e8>;
				min-residency-us = <0x7d0>;
				linux,phandle = <0x17>;
				phandle = <0x17>;
			};

			sodi3 {
				compatible = "arm,idle-state";
				arm,psci-suspend-param = <0x1010003>;
				entry-latency-us = <0x320>;
				exit-latency-us = <0x3e8>;
				min-residency-us = <0x7d0>;
				linux,phandle = <0x18>;
				phandle = <0x18>;
			};

			dpidle {
				compatible = "arm,idle-state";
				arm,psci-suspend-param = <0x1010004>;
				entry-latency-us = <0x320>;
				exit-latency-us = <0x3e8>;
				min-residency-us = <0x7d0>;
				linux,phandle = <0x19>;
				phandle = <0x19>;
			};

			suspend {
				compatible = "arm,idle-state";
				arm,psci-suspend-param = <0x1010005>;
				entry-latency-us = <0x320>;
				exit-latency-us = <0x3e8>;
				min-residency-us = <0x7d0>;
				linux,phandle = <0x1a>;
				phandle = <0x1a>;
			};
		};
	};

	memory {
		device_type = "memory";
		reg = <0x0 0x40000000 0x0 0x1e605000>;
		linux,phandle = <0x50>;
		phandle = <0x50>;
	};

	cpu_dbgapb {
		compatible = "mediatek,hw_dbg";
		num = <0x8>;
		reg = <0x0 0xd410000 0x0 0x1000 0x0 0xd510000 0x0 0x1000 0x0 0xd610000 0x0 0x1000 0x0 0xd710000 0x0 0x1000 0x0 0xd810000 0x0 0x1000 0x0 0xd910000 0x0 0x1000 0x0 0xda10000 0x0 0x1000 0x0 0xdb10000 0x0 0x1000>;
		linux,phandle = <0x51>;
		phandle = <0x51>;
	};

	reserved-memory {
		#address-cells = <0x2>;
		#size-cells = <0x2>;
		ranges;
		linux,phandle = <0x52>;
		phandle = <0x52>;

		pstore-reserved-memory@54410000 {
			compatible = "mediatek,pstore";
			reg = <0x0 0x54410000 0x0 0xe0000>;
		};

		ram_console-reserved-memory@54400000 {
			compatible = "ram_console-reserve-memory";
			reg = <0x0 0x54400000 0x0 0x10000>;
		};

		minirdump-reserved-memory@544f0000 {
			compatible = "mediatek,minirdump";
			reg = <0x0 0x544f0000 0x0 0x10000>;
		};

		atf-reserved-memory@44610000 {
			compatible = "mediatek,mt6799-atf-reserved-memory";
			no-map;
			reg = <0x0 0x54600000 0x0 0x40000>;
		};

		reserve-memory-sspm_share {
			compatible = "mediatek,reserve-memory-sspm_share";
			no-map;
			status = "disabled";
			size = <0x0 0x80000>;
			alignment = <0x0 0x10000>;
			alloc-ranges = <0x0 0x40000000 0x0 0x60000000>;
		};

		consys-reserve-memory {
			compatible = "mediatek,consys-reserve-memory";
			#address-cells = <0x2>;
			#size-cells = <0x2>;
			no-map;
			size = <0x0 0x200000>;
			alignment = <0x0 0x200000>;
			alloc-ranges = <0x0 0x40000000 0x0 0x80000000>;
		};

		soter-shared-mem {
			compatible = "microtrust,shared_mem";
			no-map;
			size = <0x0 0x200000>;
			alloc-ranges = <0x0 0x40000000 0x0 0x50000000>;
		};
	};

	plat_sram_flag@0011db00 {
		compatible = "mediatek,plat_sram_flag";
		reg = <0x0 0x11db00 0x0 0x10>;
	};

	interrupt-controller@40001000 {
		compatible = "arm,gic-v3";
		#interrupt-cells = <0x3>;
		#address-cells = <0x2>;
		#size-cells = <0x2>;
		#redistributor-regions = <0x1>;
		interrupt-controller;
		reg = <0x0 0xc000000 0x0 0x40000 0x0 0xc100000 0x0 0x200000 0x0 0xc530620 0x0 0x1000 0x0 0xc530690 0x0 0x1000>;
		interrupts = <0x1 0x9 0x4>;
		mediatek,reg_len_pol0 = <0x8>;
		linux,phandle = <0x1>;
		phandle = <0x1>;
	};

	dfd@0c530b00 {
		compatible = "mediatek,dfd";
		reg = <0x0 0xc530b00 0x0 0x10000>;
		mediatek,enabled = <0x1>;
		mediatek,chain_length = <0x61a8>;
		mediatek,rg_dfd_timeout = <0x4b0>;
	};

	clocks {

		clk_null {
			compatible = "fixed-clock";
			#clock-cells = <0x0>;
			clock-frequency = <0x0>;
			linux,phandle = <0x53>;
			phandle = <0x53>;
		};

		clk26m {
			compatible = "fixed-clock";
			#clock-cells = <0x0>;
			clock-frequency = <0x18cba80>;
			linux,phandle = <0x41>;
			phandle = <0x41>;
		};

		clk32k {
			compatible = "fixed-clock";
			#clock-cells = <0x0>;
			clock-frequency = <0x7d00>;
			linux,phandle = <0x23>;
			phandle = <0x23>;
		};
	};

	dramc_sram_debug@0011d800 {
		compatible = "mediatek,dramc_sram_debug";
		reg = <0x0 0x11d800 0x0 0x100>;
		linux,phandle = <0x54>;
		phandle = <0x54>;
	};

	topckgen@10000000 {
		compatible = "mediatek,topckgen";
		reg = <0x0 0x10000000 0x0 0x1000>;
		#clock-cells = <0x1>;
		linux,phandle = <0x40>;
		phandle = <0x40>;
	};

	infracfg_ao@10001000 {
		compatible = "mediatek,infracfg_ao", "syscon";
		reg = <0x0 0x10001000 0x0 0x1000>;
		interrupts = <0x0 0x93 0x1>;
		#clock-cells = <0x1>;
		linux,phandle = <0x5>;
		phandle = <0x5>;
	};

	scpsys@10001000 {
		compatible = "mediatek,scpsys";
		reg = <0x0 0x10001000 0x0 0x1000 0x0 0x10006000 0x0 0x1000 0x0 0x1020e000 0x0 0x1000 0x0 0x10000000 0x0 0x1000 0x0 0x1a001000 0x0 0x1000 0x0 0x14019000 0x0 0x1000>;
		#clock-cells = <0x1>;
		linux,phandle = <0x2e>;
		phandle = <0x2e>;
	};

	iocfg_lt@11f20000 {
		compatible = "mediatek,iocfg_lt";
		reg = <0x0 0x11f20000 0x0 0x1000>;
	};

	syscfg_pctl_lt@11f20000 {
		compatible = "mediatek,mt6763-pctl-lt-syscfg", "syscon";
		reg = <0x0 0x11f20000 0x0 0x1000>;
		linux,phandle = <0x25>;
		phandle = <0x25>;
	};

	iocfg_lm@11e80000 {
		compatible = "mediatek,iocfg_lm";
		reg = <0x0 0x11e80000 0x0 0x1000>;
	};

	syscfg_pctl_lm@11e80000 {
		compatible = "mediatek,mt6763-pctl-lm-syscfg", "syscon";
		reg = <0x0 0x11e80000 0x0 0x1000>;
		linux,phandle = <0x26>;
		phandle = <0x26>;
	};

	iocfg_lb@11e70000 {
		compatible = "mediatek,iocfg_lb";
		reg = <0x0 0x11e70000 0x0 0x1000>;
	};

	syscfg_pctl_lb@11e70000 {
		compatible = "mediatek,mt6763-pctl-lb-syscfg", "syscon";
		reg = <0x0 0x11e70000 0x0 0x1000>;
		linux,phandle = <0x27>;
		phandle = <0x27>;
	};

	iocfg_bl@11e90000 {
		compatible = "mediatek,iocfg_bl";
		reg = <0x0 0x11e90000 0x0 0x1000>;
	};

	syscfg_pctl_bl@11e90000 {
		compatible = "mediatek,mt6763-pctl-bl-syscfg", "syscon";
		reg = <0x0 0x11e90000 0x0 0x1000>;
		linux,phandle = <0x28>;
		phandle = <0x28>;
	};

	iocfg_rb@11d30000 {
		compatible = "mediatek,iocfg_rb";
		reg = <0x0 0x11d30000 0x0 0x1000>;
	};

	syscfg_pctl_rb@11d30000 {
		compatible = "mediatek,mt6763-pctl-rb-syscfg", "syscon";
		reg = <0x0 0x11d30000 0x0 0x1000>;
		linux,phandle = <0x29>;
		phandle = <0x29>;
	};

	iocfg_rm@11d20000 {
		compatible = "mediatek,iocfg_rm";
		reg = <0x0 0x11d20000 0x0 0x1000>;
	};

	syscfg_pctl_rm@11d20000 {
		compatible = "mediatek,mt6763-pctl-rm-syscfg", "syscon";
		reg = <0x0 0x11d20000 0x0 0x1000>;
		linux,phandle = <0x2a>;
		phandle = <0x2a>;
	};

	iocfg_rt@11c50000 {
		compatible = "mediatek,iocfg_rt";
		reg = <0x0 0x11c50000 0x0 0x1000>;
	};

	syscfg_pctl_rt@11c50000 {
		compatible = "mediatek,mt6763-pctl-rt-syscfg", "syscon";
		reg = <0x0 0x11c50000 0x0 0x1000>;
		linux,phandle = <0x2b>;
		phandle = <0x2b>;
	};

	iocfg_tl@11f30000 {
		compatible = "mediatek,iocfg_tl";
		reg = <0x0 0x11f30000 0x0 0x1000>;
	};

	syscfg_pctl_tl@11f30000 {
		compatible = "mediatek,mt6763-pctl-tl-syscfg", "syscon";
		reg = <0x0 0x11f30000 0x0 0x1000>;
		linux,phandle = <0x2c>;
		phandle = <0x2c>;
	};

	pericfg@10003000 {
		compatible = "mediatek,pericfg";
		reg = <0x0 0x10003000 0x0 0x1000>;
	};

	cpuxgpt@10200000 {
		compatible = "mediatek,mt6797-cpuxgpt";
		reg = <0x0 0x10200000 0x0 0x1000>;
		interrupts = <0x0 0x40 0x4 0x0 0x41 0x4 0x0 0x42 0x4 0x0 0x43 0x4 0x0 0x44 0x4 0x0 0x45 0x4 0x0 0x46 0x4 0x0 0x47 0x4 0x0 0x142 0x4 0x0 0x143 0x4>;
		linux,phandle = <0x55>;
		phandle = <0x55>;
	};

	timer {
		compatible = "arm,armv8-timer";
		interrupts = <0x1 0xd 0x8 0x1 0xe 0x8 0x1 0xb 0x8 0x1 0xa 0x8>;
		clock-frequency = <0xc65d40>;
		linux,phandle = <0x56>;
		phandle = <0x56>;
	};

	apxgpt@10008000 {
		compatible = "mediatek,apxgpt";
		reg = <0x0 0x10008000 0x0 0x100>;
		interrupts = <0x0 0xa6 0x8>;
		clocks = <0x23>;
	};

	dramc0@10004000 {
		compatible = "mediatek,dramc0";
		reg = <0x0 0x10004000 0x0 0x1000>;
	};

	gpio {
		compatible = "mediatek,gpio_usage_mapping";
		linux,phandle = <0x57>;
		phandle = <0x57>;
	};

	gpio@10005000 {
		compatible = "mediatek,gpio";
		reg = <0x0 0x10005000 0x0 0x1000>;
		linux,phandle = <0x58>;
		phandle = <0x58>;
	};

	syscfg_pctl_a@10005000 {
		compatible = "mediatek,mt6763-pctl-a-syscfg", "syscon";
		reg = <0x0 0x10005000 0x0 0x1000>;
		linux,phandle = <0x24>;
		phandle = <0x24>;
	};

	pinctrl@10005000 {
		compatible = "mediatek,pinctrl";
		reg = <0x0 0x10005000 0x0 0x1000>;
		mediatek,pctl-regmap = <0x24 0x25 0x26 0x27 0x28 0x29 0x2a 0x2b 0x2c>;
		pins-are-numbered;
		gpio-controller;
		#gpio-cells = <0x2>;
		linux,phandle = <0xb>;
		phandle = <0xb>;

		ufshci_va09on {
			linux,phandle = <0x42>;
			phandle = <0x42>;

			pins_cmd_dat {
				pins = <0x8300>;
				slew-rate = <0x1>;
				output-low;
				bias-disable;
			};
		};

		ufshci_va09off {
			linux,phandle = <0x43>;
			phandle = <0x43>;

			pins_cmd_dat {
				pins = <0x8300>;
				slew-rate = <0x1>;
				output-high;
				bias-disable;
			};
		};

		m4u@0 {
			cell-index = <0x0>;
			compatible = "mediatek,iommu-m4u";
			#iommu-cells = <0x1>;
			linux,phandle = <0x2d>;
			phandle = <0x2d>;
		};

		pseudo-m4u {
			compatible = "mediatek,pseudo-m4u";
			iommus = <0x2d 0x3>;
		};

		pseudo-m4u-larb0 {
			compatible = "mediatek,pseudo-port-m4u";
			mediatek,larbid = <0x0>;
			iommus = <0x2d 0x0 0x2d 0x1 0x2d 0x2 0x2d 0x3 0x2d 0x4 0x2d 0x5 0x2d 0x6 0x2d 0x7 0x2d 0x8 0x2d 0x9>;
		};

		pseudo-m4u-larb1 {
			compatible = "mediatek,pseudo-port-m4u";
			mediatek,larbid = <0x1>;
			iommus = <0x2d 0xa 0x2d 0xb 0x2d 0xc 0x2d 0xd 0x2d 0xe 0x2d 0xf 0x2d 0x10 0x2d 0x11 0x2d 0x12 0x2d 0x13>;
		};

		pseudo-m4u-larb2 {
			compatible = "mediatek,pseudo-port-m4u";
			mediatek,larbid = <0x2>;
			iommus = <0x2d 0x14 0x2d 0x15 0x2d 0x16 0x2d 0x17 0x2d 0x18 0x2d 0x19 0x2d 0x1a 0x2d 0x1b 0x2d 0x1c 0x2d 0x1d 0x2d 0x1e 0x2d 0x1f 0x2d 0x20 0x2d 0x21 0x2d 0x22 0x2d 0x23 0x2d 0x24 0x2d 0x25>;
		};

		pseudo-m4u-larb3 {
			compatible = "mediatek,pseudo-port-m4u";
			mediatek,larbid = <0x3>;
			iommus = <0x2d 0x26 0x2d 0x27 0x2d 0x28 0x2d 0x29 0x2d 0x2a 0x2d 0x2b 0x2d 0x2c 0x2d 0x2d 0x2d 0x2e 0x2d 0x2f 0x2d 0x30>;
		};

		msdc0@default {
			linux,phandle = <0x2>;
			phandle = <0x2>;

			pins_cmd {
				drive-strength = [03];
			};

			pins_dat {
				drive-strength = [03];
			};

			pins_clk {
				drive-strength = [03];
			};

			pins_rst {
				drive-strength = [03];
			};

			pins_ds {
				drive-strength = [01];
			};
		};

		msdc0@register_default {
			cmd_edge = [00];
			rdata_edge = [00];
			wdata_edge = [00];
			linux,phandle = <0x3>;
			phandle = <0x3>;
		};

		msdc1@default {
			linux,phandle = <0x6>;
			phandle = <0x6>;

			pins_cmd {
				drive-strength = [03];
			};

			pins_dat {
				drive-strength = [03];
			};

			pins_clk {
				drive-strength = [04];
			};
		};

		msdc1@sdr104 {
			linux,phandle = <0x7>;
			phandle = <0x7>;

			pins_cmd {
				drive-strength = [03];
			};

			pins_dat {
				drive-strength = [03];
			};

			pins_clk {
				drive-strength = [03];
			};
		};

		msdc1@sdr50 {
			linux,phandle = <0x8>;
			phandle = <0x8>;

			pins_cmd {
				drive-strength = [03];
			};

			pins_dat {
				drive-strength = [03];
			};

			pins_clk {
				drive-strength = [03];
			};
		};

		msdc1@ddr50 {
			linux,phandle = <0x9>;
			phandle = <0x9>;

			pins_cmd {
				drive-strength = [03];
			};

			pins_dat {
				drive-strength = [03];
			};

			pins_clk {
				drive-strength = [03];
			};
		};

		msdc1@register_default {
			cmd_edge = [00];
			rdata_edge = [00];
			wdata_edge = [00];
			linux,phandle = <0xa>;
			phandle = <0xa>;
		};

		msdc2@default {
			linux,phandle = <0xe>;
			phandle = <0xe>;

			pins_cmd {
				drive-strength = [03];
			};

			pins_dat {
				drive-strength = [03];
			};

			pins_clk {
				drive-strength = [03];
			};
		};

		msdc2@register_default {
			cmd_edge = [00];
			rdata_edge = [00];
			wdata_edge = [00];
			linux,phandle = <0xf>;
			phandle = <0xf>;
		};
	};

	dvfsp@10940000 {
		compatible = "mediatek,mt6763-dvfsp";
		reg = <0x0 0x10940000 0x0 0x10000 0x0 0x11bc00 0x0 0x1400>;
	};

	mcdi@0011b000 {
		compatible = "mediatek,mt6763-mcdi";
		reg = <0x0 0x11b000 0x0 0x800>;
	};

	sleep@10006000 {
		compatible = "mediatek,sleep";
		reg = <0x0 0x10006000 0x0 0x1000>;
		interrupts = <0x0 0xb1 0x8>;
	};

	toprgu@10007000 {
		compatible = "mediatek,mt6763-toprgu";
		reg = <0x0 0x10007000 0x0 0x1000>;
		interrupts = <0x0 0x8b 0x0 0x0 0xc8 0x4>;
	};

	rsvd@10009000 {
		compatible = "mediatek,rsvd";
		reg = <0x0 0x10009000 0x0 0x1000>;
	};

	hacc@1000a000 {
		compatible = "mediatek,hacc";
		reg = <0x0 0x1000a000 0x0 0x1000>;
		interrupts = <0x0 0xb9 0x8>;
	};

	eintc@1000b000 {
		compatible = "mediatek,mt-eic";
		reg = <0x0 0x1000b000 0x0 0x1000>;
		interrupts = <0x0 0xa7 0x4>;
		mediatek,max_hw_deb_cnt = <0xd>;
		mediatek,max_deint_cnt = <0x4>;
		mediatek,deint_possible_irq = <0xcb 0xcc 0xcd 0xce>;
		#interrupt-cells = <0x2>;
		interrupt-controller;
		mediatek,max_eint_num = <0x98>;
		mediatek,debtime_setting_entry = <0xa>;
		mediatek,debtime_setting_array = <0x0 0x80 0x1 0x100 0x2 0x200 0x3 0x400 0x4 0x4000 0x5 0x8000 0x6 0x10000 0x7 0x20000 0x8 0x40000 0x9 0x80000>;
		linux,phandle = <0x59>;
		phandle = <0x59>;
	};

	apmixed@1000c000 {
		compatible = "mediatek,apmixed";
		reg = <0x0 0x1000c000 0x0 0x1000>;
		#clock-cells = <0x1>;
		linux,phandle = <0x5a>;
		phandle = <0x5a>;
	};

	fhctl@1000ce00 {
		compatible = "mediatek,fhctl";
		reg = <0x0 0x1000ce00 0x0 0x1000>;
	};

	pwrap@1000d000 {
		compatible = "mediatek,pwrap";
		reg = <0x0 0x1000d000 0x0 0x1000>;
		interrupts = <0x0 0xaf 0x4>;

		pmic_irq {
			compatible = "mediatek,pmic-eint";
			interrupt-controller;
			linux,phandle = <0x5b>;
			phandle = <0x5b>;
		};
	};

	pwrap_mpu@1000d000 {
		compatible = "mediatek,pwrap_mpu";
		reg = <0x0 0x1000d000 0x0 0x1000>;
	};

	pwrap_p2p@1005e000 {
		compatible = "mediatek,pwrap_p2p";
		reg = <0x0 0x1005e000 0x0 0x1000>;
	};

	pwrap_md32@10448000 {
		compatible = "mediatek,pwrap_md32";
		reg = <0x0 0x10448000 0x0 0x1000>;
	};

	sleep_reg_md@1000f000 {
		compatible = "mediatek,sleep_reg_md";
		reg = <0x0 0x1000f000 0x0 0x1000>;
	};

	kp@10010000 {
		compatible = "mediatek,kp";
		reg = <0x0 0x10010000 0x0 0x1000>;
		interrupts = <0x0 0xb0 0x2>;
		linux,phandle = <0x5c>;
		phandle = <0x5c>;
	};

	topmisc@10011000 {
		compatible = "mediatek,topmisc";
		reg = <0x0 0x10011000 0x0 0x1000>;
	};

	dvfsrc_top@10012000 {
		compatible = "mediatek,dvfsrc_top";
		reg = <0x0 0x10012000 0x0 0x1000>;
	};

	apcldmain_ao@10014000 {
		compatible = "mediatek,apcldmain_ao";
		reg = <0x0 0x10014000 0x0 0x1000>;
	};

	mdcldma@10014000 {
		compatible = "mediatek,mdcldma";
		reg = <0x0 0x10014000 0x0 0x1000 0x0 0x1021b000 0x0 0x1000 0x0 0x10209000 0x0 0x1000 0x0 0x1020a000 0x0 0x1000>;
		interrupts = <0x0 0xa5 0x4 0x0 0x94 0x8 0x0 0x95 0x8 0x0 0x107 0x2>;
		mediatek,md_id = <0x0>;
		mediatek,cldma_capability = <0x6>;
		clocks = <0x2e 0x1 0x5 0x37 0x5 0x2e 0x5 0x31 0x5 0x26 0x5 0x27>;
		clock-names = "scp-sys-md1-main", "infra-cldma-bclk", "infra-ccif-ap", "infra-ccif-md", "infra-ccif1-ap", "infra-ccif1-md";
		linux,phandle = <0x5d>;
		phandle = <0x5d>;
	};

	apcldmaout_ao@10014400 {
		compatible = "mediatek,apcldmaout_ao";
		reg = <0x0 0x10014400 0x0 0x1000>;
	};

	apcldmamisc_ao@10014800 {
		compatible = "mediatek,apcldmamisc_ao";
		reg = <0x0 0x10014800 0x0 0x1000>;
	};

	mdcldmain_ao@10015000 {
		compatible = "mediatek,mdcldmain_ao";
		reg = <0x0 0x10015000 0x0 0x1000>;
	};

	mdcldmaout_ao@10015400 {
		compatible = "mediatek,mdcldmaout_ao";
		reg = <0x0 0x10015400 0x0 0x1000>;
	};

	mdcldmamisc_ao@10015800 {
		compatible = "mediatek,mdcldmamisc_ao";
		reg = <0x0 0x10015800 0x0 0x1000>;
	};

	aes_top0@10016000 {
		compatible = "mediatek,aes_top0";
		reg = <0x0 0x10016000 0x0 0x1000>;
	};

	sys_timer@10017000 {
		compatible = "mediatek,sys_timer";
		reg = <0x0 0x10017000 0x0 0x1000>;
		reg-names = "sys_timer_base";
		interrupts = <0x0 0xbe 0x4>;
	};

	modem_temp_share@10018000 {
		compatible = "mediatek,modem_temp_share";
		reg = <0x0 0x10018000 0x0 0x1000>;
	};

	mbist_ao@10013000 {
		compatible = "mediatek,mbist_ao";
		reg = <0x0 0x10013000 0x0 0x1000>;
	};

	security_ao@1001a000 {
		compatible = "mediatek,security_ao";
		reg = <0x0 0x1001a000 0x0 0x1000>;
	};

	topckgen_ao@1001b000 {
		compatible = "mediatek,topckgen_ao";
		reg = <0x0 0x1001b000 0x0 0x1000>;
	};

	dbgapb@0d000000 {
		compatible = "mediatek,dbgapb";
		reg = <0x0 0xd000000 0x0 0x1000>;
	};

	mcucfg@0c530000 {
		compatible = "mediatek,mcucfg";
		reg = <0x0 0xc530000 0x0 0x1000>;
		interrupts = <0x0 0x0 0x8>;
	};

	mp0_cpucfg@0c530000 {
		compatible = "mediatek,mp0_cpucfg";
		reg = <0x0 0xc530000 0x0 0x1000>;
	};

	mp1_cpucfg@0c530200 {
		compatible = "mediatek,mp1_cpucfg";
		reg = <0x0 0xc530200 0x0 0x1000>;
	};

	mcu_misccfg@0c530400 {
		compatible = "mediatek,mcu_misccfg";
		reg = <0x0 0xc530400 0x0 0x1000>;
	};

	mcu_misc1cfg@0c530800 {
		compatible = "mediatek,mcu_misc1cfg";
		reg = <0x0 0xc530800 0x0 0x1000>;
	};

	infracfg@1020e000 {
		compatible = "mediatek,infracfg";
		reg = <0x0 0x1020e000 0x0 0x1000>;
	};

	sramrom@10214000 {
		compatible = "mediatek,sramrom";
		reg = <0x0 0x10214000 0x0 0x1000>;
	};

	emi@10219000 {
		compatible = "mediatek,emi";
		reg = <0x0 0x10219000 0x0 0x1000 0x0 0x10226000 0x0 0x1000 0x0 0x1022d000 0x0 0x1000 0x0 0x10235000 0x0 0x1000>;
		interrupts = <0x0 0x90 0x8 0x0 0x91 0x4 0x0 0x98 0x4>;
	};

	sys_cirq@10204000 {
		compatible = "mediatek,sys_cirq";
		reg = <0x0 0x10204000 0x0 0x1000>;
		mediatek,cirq_num = <0xd0>;
		mediatek,spi_start_offset = <0x48>;
		interrupts = <0x0 0x118 0x8>;
	};

	m4u@10205000 {
		cell-index = <0x0>;
		compatible = "mediatek,m4u";
		reg = <0x0 0x10205000 0x0 0x1000>;
		interrupts = <0x0 0x9e 0x8>;
	};

	devapc@10207000 {
		compatible = "mediatek,devapc";
		reg = <0x0 0x10207000 0x0 0x1000>;
		interrupts = <0x0 0x8e 0x8>;
		clocks = <0x5 0x2d>;
		clock-names = "devapc-infra-clock";
	};

	bus_dbg@10208000 {
		compatible = "mediatek,bus_dbg-v2";
		reg = <0x0 0x10208000 0x0 0x1000>;
		interrupts = <0x0 0x8d 0x8>;
	};

	ap_ccif0@10209000 {
		compatible = "mediatek,ap_ccif0";
		reg = <0x0 0x10209000 0x0 0x1000>;
		interrupts = <0x0 0x94 0x8>;
	};

	md_ccif0@9020a000 {
		compatible = "mediatek,md_ccif0";
		reg = <0x0 0x9020a000 0x0 0x1000>;
	};

	ap_ccif1@1020b000 {
		compatible = "mediatek,ap_ccif1";
		reg = <0x0 0x1020b000 0x0 0x1000>;
		interrupts = <0x0 0x96 0x8>;
	};

	md_ccif1@9020c000 {
		compatible = "mediatek,md_ccif1";
		reg = <0x0 0x9020c000 0x0 0x1000>;
	};

	infra_mbist@1020d000 {
		compatible = "mediatek,infra_mbist";
		reg = <0x0 0x1020d000 0x0 0x1000>;
	};

	dramc_nao@1020e000 {
		compatible = "mediatek,dramc_nao";
		reg = <0x0 0x1020e000 0x0 0x1000>;
	};

	trng@1020f000 {
		compatible = "mediatek,trng";
		reg = <0x0 0x1020f000 0x0 0x1000>;
		interrupts = <0x0 0xa1 0x8>;
	};

	dxcc_sec@10210000 {
		compatible = "mediatek,dxcc_sec";
		reg = <0x0 0x10210000 0x0 0x1000>;
		interrupts = <0x0 0xa2 0x4>;
	};

	smi_common_ao@10211000 {
		compatible = "mediatek,smi_common_ao";
		reg = <0x0 0x10211000 0x0 0x1000>;
	};

	rccif_ps_c2k@90211000 {
		compatible = "mediatek,rccif_ps_c2k";
		reg = <0x0 0x90211000 0x0 0x1000>;
	};

	rccif_l1_c2k@90211400 {
		compatible = "mediatek,rccif_l1_c2k";
		reg = <0x0 0x90211400 0x0 0x1000>;
	};

	md2md_pccif_md1@90211800 {
		compatible = "mediatek,md2md_pccif_md1";
		reg = <0x0 0x90211800 0x0 0x1000>;
	};

	cq_dma@10212000 {
		compatible = "mediatek,mt-cqdma-v1";
		reg = <0x0 0x10212000 0x0 0x80 0x0 0x10212080 0x0 0x80 0x0 0x10212100 0x0 0x80>;
		interrupts = <0x0 0x71 0x8 0x0 0x72 0x8 0x0 0x73 0x8>;
		nr_channel = <0x3>;
		clocks = <0x5 0x4e>;
		clock-names = "cqdma";
	};

	rccif_c2k_ps@90213000 {
		compatible = "mediatek,rccif_c2k_ps";
		reg = <0x0 0x90213000 0x0 0x1000>;
	};

	rccif_c2k_l1@90213400 {
		compatible = "mediatek,rccif_c2k_l1";
		reg = <0x0 0x90213400 0x0 0x1000>;
	};

	md2md_pccif_md2@90213800 {
		compatible = "mediatek,md2md_pccif_md2";
		reg = <0x0 0x90213800 0x0 0x1000>;
	};

	mipi_tx0@11e50000 {
		compatible = "mediatek,mipi_tx0";
		reg = <0x0 0x11e50000 0x0 0x1000>;
	};

	mipi_tx1@10216000 {
		compatible = "mediatek,mipi_tx1";
		reg = <0x0 0x10216000 0x0 0x1000>;
	};

	mipi_rx_ana_csi0a@11c80000 {
		compatible = "mediatek,mipi_rx_ana_csi0a";
		reg = <0x0 0x11c80000 0x0 0x1000>;
	};

	mipi_rx_ana_csi0b@11c81000 {
		compatible = "mediatek,mipi_rx_ana_csi0b";
		reg = <0x0 0x11c81000 0x0 0x1000>;
	};

	mipi_rx_ana_csi1a@11c90000 {
		compatible = "mediatek,mipi_rx_ana_csi1a";
		reg = <0x0 0x11c90000 0x0 0x1000>;
	};

	mipi_rx_ana_csi1b@11c91000 {
		compatible = "mediatek,mipi_rx_ana_csi1b";
		reg = <0x0 0x11c91000 0x0 0x1000>;
	};

	gcpu_rsa@1021a000 {
		compatible = "mediatek,gcpu_rsa";
		reg = <0x0 0x1021a000 0x0 0x1000>;
	};

	apcldmain@1021b000 {
		compatible = "mediatek,apcldmain";
		reg = <0x0 0x1021b000 0x0 0x1000>;
	};

	apcldmaout@1021b400 {
		compatible = "mediatek,apcldmaout";
		reg = <0x0 0x1021b400 0x0 0x1000>;
	};

	apcldmamisc@1021b800 {
		compatible = "mediatek,apcldmamisc";
		reg = <0x0 0x1021b800 0x0 0x1000>;
		interrupts = <0x0 0xa5 0x4>;
	};

	mdcldmain@1021c000 {
		compatible = "mediatek,mdcldmain";
		reg = <0x0 0x1021c000 0x0 0x1000>;
	};

	mdcldmaout@1021c400 {
		compatible = "mediatek,mdcldmaout";
		reg = <0x0 0x1021c400 0x0 0x1000>;
	};

	mdcldmamisc@1021c800 {
		compatible = "mediatek,mdcldmamisc";
		reg = <0x0 0x1021c800 0x0 0x1000>;
	};

	infra_md@1021d000 {
		compatible = "mediatek,infra_md";
		reg = <0x0 0x1021d000 0x0 0x1000>;
	};

	infra_md_cfg@1021d000 {
		compatible = "mediatek,infra_md_cfg";
		reg = <0x0 0x1021d000 0x0 0x1000>;
	};

	bpi_bsi_slv0@1021e000 {
		compatible = "mediatek,bpi_bsi_slv0";
		reg = <0x0 0x1021e000 0x0 0x1000>;
	};

	bpi_bsi_slv1@1021f000 {
		compatible = "mediatek,bpi_bsi_slv1";
		reg = <0x0 0x1021f000 0x0 0x1000>;
	};

	bpi_bsi_slv2@10225000 {
		compatible = "mediatek,bpi_bsi_slv2";
		reg = <0x0 0x10225000 0x0 0x1000>;
	};

	dvfsp@10227000 {
		compatible = "mediatek,dvfsp";
		reg = <0x0 0x10227000 0x0 0x1000>;
		interrupts = <0x0 0xa3 0x8>;
	};

	dramc@1022a000 {
		compatible = "mediatek,dramc";
		reg = <0x0 0x1022a000 0x0 0x2000 0x0 0x10232000 0x0 0x2000 0x0 0x1022c000 0x0 0x1000 0x0 0x10234000 0x0 0x1000 0x0 0x10228000 0x0 0x2000 0x0 0x10230000 0x0 0x2000 0x0 0x1022e000 0x0 0x2000 0x0 0x10236000 0x0 0x2000>;
	};

	fmem_smi@10238000 {
		compatible = "mediatek,fmem_smi";
		reg = <0x0 0x10238000 0x0 0x1000>;
	};

	gce@10238000 {
		compatible = "mediatek,gce";
		reg = <0x0 0x10238000 0x0 0x1000>;
		interrupts = <0x0 0x9a 0x8 0x0 0x9b 0x8>;
		disp_mutex_reg = <0x14016000 0x1000>;
		g3d_config_base = <0x13000000 0x0 0xffff0000>;
		mmsys_config_base = <0x14000000 0x1 0xffff0000>;
		disp_dither_base = <0x14010000 0x2 0xffff0000>;
		mm_na_base = <0x14020000 0x3 0xffff0000>;
		imgsys_base = <0x15020000 0x4 0xffff0000>;
		vdec_gcon_base = <0x18800000 0x5 0xffff0000>;
		venc_gcon_base = <0x18810000 0x6 0xffff0000>;
		conn_peri_base = <0x18820000 0x7 0xffff0000>;
		topckgen_base = <0x18830000 0x8 0xffff0000>;
		kp_base = <0x18840000 0x9 0xffff0000>;
		scp_sram_base = <0x10000000 0xa 0xffff0000>;
		infra_na3_base = <0x10010000 0xb 0xffff0000>;
		infra_na4_base = <0x10020000 0xc 0xffff0000>;
		scp_base = <0x10030000 0xd 0xffff0000>;
		mcucfg_base = <0x10040000 0xe 0xffff0000>;
		gcpu_base = <0x10050000 0xf 0xffff0000>;
		usb0_base = <0x10200000 0x10 0xffff0000>;
		usb_sif_base = <0x10280000 0x11 0xffff0000>;
		audio_base = <0x17000000 0x12 0xffff0000>;
		vdec_base = <0x17010000 0x13 0xffff0000>;
		msdc2_base = <0x17020000 0x14 0xffff0000>;
		vdec1_base = <0x17030000 0x15 0xffff0000>;
		msdc3_base = <0x18000000 0x16 0xffff0000>;
		ap_dma_base = <0x18010000 0x17 0xffff0000>;
		gce_base = <0x18020000 0x18 0xffff0000>;
		vdec2_base = <0x18040000 0x19 0xffff0000>;
		vdec3_base = <0x18050000 0x1a 0xffff0000>;
		camsys_base = <0x18080000 0x1b 0xffff0000>;
		camsys1_base = <0x180a0000 0x1c 0xffff0000>;
		camsys2_base = <0x180b0000 0x1d 0xffff0000>;
		pwm_sw_base = <0x11000000 0x63 0xffff0000>;
		disp_rdma0_sof = <0x0>;
		disp_rdma1_sof = <0x1>;
		mdp_rdma0_sof = <0x2>;
		mdp_rsz0_sof = <0x4>;
		mdp_rsz1_sof = <0x5>;
		mdp_tdshp_sof = <0x6>;
		mdp_wrot0_sof = <0x7>;
		mdp_wdma_sof = <0x8>;
		disp_ovl0_sof = <0x9>;
		disp_2l_ovl0_sof = <0xa>;
		disp_2l_ovl1_sof = <0xb>;
		disp_wdma0_sof = <0xc>;
		disp_color0_sof = <0xd>;
		disp_ccorr0_sof = <0xe>;
		disp_aal0_sof = <0xf>;
		disp_gamma0_sof = <0x10>;
		disp_dither0_sof = <0x11>;
		disp_pwm0_sof = <0x12>;
		disp_dsi0_sof = <0x13>;
		disp_dpi0_sof = <0x14>;
		disp_rdma0_frame_done = <0x17>;
		disp_rdma1_frame_done = <0x18>;
		mdp_rdma0_frame_done = <0x19>;
		mdp_rsz0_frame_done = <0x1b>;
		mdp_rsz1_frame_done = <0x1c>;
		mdp_tdshp_frame_done = <0x1d>;
		mdp_wrot0_write_frame_done = <0x1e>;
		mdp_wdma_frame_done = <0x1f>;
		disp_ovl0_frame_done = <0x20>;
		disp_2l_ovl0_frame_done = <0x21>;
		disp_2l_ovl1_frame_done = <0x22>;
		disp_wdma0_frame_done = <0x23>;
		disp_color0_frame_done = <0x24>;
		disp_ccorr0_frame_done = <0x25>;
		disp_aal0_frame_done = <0x26>;
		disp_gamma0_frame_done = <0x27>;
		disp_dither0_frame_done = <0x28>;
		disp_dsi0_frame_done = <0x29>;
		disp_dpi0_frame_done = <0x2a>;
		stream_done_0 = <0x82>;
		stream_done_1 = <0x83>;
		stream_done_2 = <0x84>;
		stream_done_3 = <0x85>;
		stream_done_4 = <0x86>;
		stream_done_5 = <0x87>;
		stream_done_6 = <0x88>;
		stream_done_7 = <0x89>;
		stream_done_8 = <0x8a>;
		stream_done_9 = <0x8b>;
		stream_done_10 = <0x8c>;
		stream_done_11 = <0x8d>;
		buf_underrun_event_0 = <0x8e>;
		buf_underrun_event_1 = <0x8f>;
		dsi0_te_event = <0x90>;
		dsi0_irq_event = <0x91>;
		dsi0_done_event = <0x92>;
		disp_wdma0_rst_done = <0x96>;
		mdp_wdma_rst_done = <0x97>;
		mdp_wrot0_rst_done = <0x98>;
		mdp_rdma0_rst_done = <0x9a>;
		disp_ovl0_frame_rst_done_pusle = <0x9b>;
		disp_ovl0_2l_frame_rst_done_pusle = <0x9c>;
		disp_ovl1_2l_frame_rst_done_pusle = <0x9d>;
		dip_cq_thread0_frame_done = <0x101>;
		dip_cq_thread1_frame_done = <0x102>;
		dip_cq_thread2_frame_done = <0x103>;
		dip_cq_thread3_frame_done = <0x104>;
		dip_cq_thread4_frame_done = <0x105>;
		dip_cq_thread5_frame_done = <0x106>;
		dip_cq_thread6_frame_done = <0x107>;
		dip_cq_thread7_frame_done = <0x108>;
		dip_cq_thread8_frame_done = <0x109>;
		dip_cq_thread9_frame_done = <0x10a>;
		dip_cq_thread10_frame_done = <0x10b>;
		dip_cq_thread11_frame_done = <0x10c>;
		dip_cq_thread12_frame_done = <0x10d>;
		dip_cq_thread13_frame_done = <0x10e>;
		dip_cq_thread14_frame_done = <0x10f>;
		dve_frame_done = <0x110>;
		wmf_frame_done = <0x111>;
		gepf_frame_done = <0x112>;
		gepf_temp_frame_done = <0x113>;
		gepf_bypass_frame_done = <0x114>;
		rsc_frame_done = <0x115>;
		venc_done = <0x121>;
		jpgenc_done = <0x122>;
		jpgdec_done = <0x123>;
		venc_mb_done = <0x124>;
		venc_128byte_cnt_done = <0x125>;
		isp_frame_done_a = <0x141>;
		isp_frame_done_b = <0x142>;
		camsv_0_pass1_done = <0x143>;
		camsv_1_pass1_done = <0x144>;
		camsv_2_pass1_done = <0x145>;
		tsf_done = <0x146>;
		seninf_0_fifo_full = <0x147>;
		seninf_1_fifo_full = <0x148>;
		seninf_2_fifo_full = <0x149>;
		seninf_3_fifo_full = <0x14a>;
		seninf_4_fifo_full = <0x14b>;
		seninf_5_fifo_full = <0x14c>;
		seninf_6_fifo_full = <0x14d>;
		seninf_7_fifo_full = <0x14e>;
		dsi0_te_from_infra = <0x382>;
		max_prefetch_cnt = <0x4>;
		prefetch_size = <0x100 0x20 0x20 0x20>;
		sram_size_cpr_64 = <0x110>;
		mmsys_config = <0x2f>;
		mm_mutex = <0x30>;
		mdp_rdma0 = <0x31>;
		mdp_rdma1 = <0x32>;
		mdp_rsz0 = <0x33>;
		mdp_rsz1 = <0x34>;
		mdp_wrot0 = <0x35>;
		mdp_wdma0 = <0x36>;
		mdp_tdshp0 = <0x37>;
		disp_color0 = <0x38>;
		disp_ovl0 = <0x39>;
		disp_ovl0_2l = <0x3a>;
		disp_ovl1_2l = <0x3b>;
		venc = <0x3c>;
		msdc0 = <0x3d>;
		audio = <0x3e>;
		uart = <0x3f>;
		sram_share_cnt = <0x1>;
		sram_share_engine = <0xb>;
		sram_share_event = <0x2c6>;
		clocks = <0x5 0x9 0x5 0x19>;
		clock-names = "GCE", "GCE_TIMER";
	};

	met_cci_pmu@10390000 {
		compatible = "mediatek,met_cci_pmu";
		reg = <0x0 0x10390000 0x0 0x10000>;
	};

	sspm@10440000 {
		compatible = "mediatek,sspm";
		reg = <0x0 0x10440000 0x0 0x1000 0x0 0x10450000 0x0 0x100 0x0 0x10451000 0x0 0x8 0x0 0x10460000 0x0 0x100 0x0 0x10461000 0x0 0x8 0x0 0x10470000 0x0 0x100 0x0 0x10471000 0x0 0x8 0x0 0x10480000 0x0 0x100 0x0 0x10481000 0x0 0x8 0x0 0x10490000 0x0 0x100 0x0 0x10491000 0x0 0x8>;
		reg-names = "cfgreg", "mbox0_base", "mbox0_ctrl", "mbox1_base", "mbox1_ctrl", "mbox2_base", "mbox2_ctrl", "mbox3_base", "mbox3_ctrl", "mbox4_base", "mbox4_ctrl";
		interrupts = <0x0 0xc6 0x4 0x0 0xc9 0x4 0x0 0xca 0x4 0x0 0xcb 0x4 0x0 0xcc 0x4 0x0 0xcd 0x4>;
		interrupt-names = "ipc", "mbox0", "mbox1", "mbox2", "mbox3", "mbox4";
	};

	ap_dma@11000000 {
		compatible = "mediatek,ap_dma";
		reg = <0x0 0x11000000 0x0 0x1000>;
		interrupts = <0x0 0x52 0x8>;
	};

	apuart0@11002000 {
		cell-index = <0x0>;
		compatible = "mediatek,mt6735-uart";
		reg = <0x0 0x11002000 0x0 0x1000 0x0 0x11000600 0x0 0x80 0x0 0x11000680 0x0 0x80>;
		interrupts = <0x0 0x5b 0x8 0x0 0x6c 0x8 0x0 0x6d 0x8>;
		clock-frequency = <0x18cba80>;
		clock-div = <0x1>;
		clocks = <0x5 0x15 0x5 0x2b>;
		clock-names = "uart0-main", "uart-apdma";
		linux,phandle = <0x3f>;
		phandle = <0x3f>;
	};

	apuart1@11003000 {
		cell-index = <0x1>;
		compatible = "mediatek,mt6735-uart";
		reg = <0x0 0x11003000 0x0 0x1000 0x0 0x11000700 0x0 0x80 0x0 0x11000780 0x0 0x80>;
		interrupts = <0x0 0x5c 0x8 0x0 0x6e 0x8 0x0 0x6f 0x8>;
		clock-frequency = <0x18cba80>;
		clock-div = <0x1>;
		clocks = <0x5 0x16>;
		clock-names = "uart1-main";
		linux,phandle = <0x5e>;
		phandle = <0x5e>;
	};

	auxadc@11001000 {
		compatible = "mediatek,auxadc";
		reg = <0x0 0x11001000 0x0 0x1000>;
		interrupts = <0x0 0x4a 0x0>;
		clocks = <0x5 0x24>;
		clock-names = "auxadc-main";
		linux,phandle = <0x5f>;
		phandle = <0x5f>;
	};

	pwm@11006000 {
		compatible = "mediatek,pwm";
		reg = <0x0 0x11006000 0x0 0x1000>;
		interrupts = <0x0 0x4d 0x8>;
		clocks = <0x5 0x10 0x5 0x11 0x5 0x12 0x5 0x13 0x5 0xf 0x5 0x14>;
		clock-names = "PWM1-main", "PWM2-main", "PWM3-main", "PWM4-main", "PWM-HCLK-main", "PWM-main";
	};

	i2c@11007000 {
		compatible = "mediatek,mt6763-i2c";
		id = <0x0>;
		reg = <0x0 0x11007000 0x0 0x1000 0x0 0x11000100 0x0 0x80>;
		interrupts = <0x0 0x54 0x8>;
		clocks = <0x5 0xb 0x5 0x2b>;
		clock-names = "main", "dma";
		clock-div = <0x5>;
		mediatek,have-dcm;
		linux,phandle = <0x60>;
		phandle = <0x60>;
	};

	i2c@11014000 {
		compatible = "mediatek,mt6763-i2c";
		id = <0x1>;
		reg = <0x0 0x11014000 0x0 0x1000 0x0 0x11000380 0x0 0x80>;
		interrupts = <0x0 0x83 0x8>;
		clocks = <0x5 0x49 0x5 0x2b 0x5 0x48>;
		clock-names = "main", "dma", "arb";
		clock-div = <0x5>;
		mediatek,have-dcm;
		linux,phandle = <0x61>;
		phandle = <0x61>;
	};

	i2c@11015000 {
		compatible = "mediatek,mt6763-i2c";
		id = <0x2>;
		reg = <0x0 0x11015000 0x0 0x1000 0x0 0x11000400 0x0 0x80>;
		interrupts = <0x0 0x84 0x8>;
		clocks = <0x5 0x4b 0x5 0x2b 0x5 0x4a>;
		clock-names = "main", "dma", "arb";
		clock-div = <0x5>;
		mediatek,have-dcm;
		linux,phandle = <0x62>;
		phandle = <0x62>;
	};

	i2c@1100f000 {
		compatible = "mediatek,mt6763-i2c";
		id = <0x5>;
		reg = <0x0 0x1100f000 0x0 0x1000 0x0 0x11000280 0x0 0x80>;
		interrupts = <0x0 0x57 0x8>;
		clocks = <0x5 0xe 0x5 0x2b>;
		clock-names = "main", "dma";
		clock-div = <0x5>;
		mediatek,have-dcm;
		linux,phandle = <0x63>;
		phandle = <0x63>;
	};

	i2c@11011000 {
		compatible = "mediatek,mt6763-i2c";
		id = <0x3>;
		reg = <0x0 0x11011000 0x0 0x1000 0x0 0x11000300 0x0 0x80>;
		interrupts = <0x0 0x58 0x8>;
		clocks = <0x5 0x3a 0x5 0x2b>;
		clock-names = "main", "dma";
		clock-div = <0x5>;
		mediatek,have-dcm;
		linux,phandle = <0x64>;
		phandle = <0x64>;
	};

	i2c@11017000 {
		compatible = "mediatek,mt6763-i2c";
		id = <0x4>;
		reg = <0x0 0x11017000 0x0 0x1000 0x0 0x11000500 0x0 0x80>;
		interrupts = <0x0 0x85 0x8>;
		clocks = <0x5 0x47 0x5 0x2b 0x5 0x46>;
		clock-names = "main", "dma", "arb";
		clock-div = <0x5>;
		mediatek,have-dcm;
		linux,phandle = <0x65>;
		phandle = <0x65>;
	};

	i2c@11005000 {
		compatible = "mediatek,mt6763-i2c";
		id = <0x6>;
		reg = <0x0 0x11005000 0x0 0x1000 0x0 0x11000580 0x0 0x80>;
		interrupts = <0x0 0x59 0x8>;
		clocks = <0x5 0x58 0x5 0x2b>;
		clock-names = "main", "dma";
		clock-div = <0x5>;
		mediatek,have-dcm;
		mediatek,hs_only;
		linux,phandle = <0x66>;
		phandle = <0x66>;
	};

	i2c@11008000 {
		compatible = "mediatek,mt6763-i2c";
		id = <0x7>;
		reg = <0x0 0x11008000 0x0 0x1000 0x0 0x11000180 0x0 0x80>;
		interrupts = <0x0 0x55 0x8>;
		clocks = <0x5 0xc 0x5 0x2b 0x5 0x48>;
		clock-names = "main", "dma", "arb";
		clock-div = <0x5>;
		mediatek,have-dcm;
		mediatek,buffermode_used;
		linux,phandle = <0x67>;
		phandle = <0x67>;
	};

	i2c@11009000 {
		compatible = "mediatek,mt6763-i2c";
		id = <0x8>;
		reg = <0x0 0x11009000 0x0 0x1000 0x0 0x11000200 0x0 0x80>;
		interrupts = <0x0 0x56 0x8>;
		clocks = <0x5 0xd 0x5 0x2b 0x5 0x4a>;
		clock-names = "main", "dma", "arb";
		clock-div = <0x5>;
		mediatek,have-dcm;
		mediatek,buffermode_used;
		linux,phandle = <0x68>;
		phandle = <0x68>;
	};

	i2c@11016000 {
		compatible = "mediatek,mt6763-i2c";
		id = <0x9>;
		reg = <0x0 0x11016000 0x0 0x1000 0x0 0x11000480 0x0 0x80>;
		interrupts = <0x0 0x82 0x8>;
		clocks = <0x5 0x45 0x5 0x2b 0x5 0x46>;
		clock-names = "main", "dma", "arb";
		clock-div = <0x5>;
		mediatek,have-dcm;
		mediatek,buffermode_used;
		linux,phandle = <0x69>;
		phandle = <0x69>;
	};

	spi@1100a000 {
		compatible = "mediatek,mt6763-spi";
		cell-index = <0x0>;
		spi-padmacro = <0x0>;
		dma_addrmask = <0x24>;
		reg = <0x0 0x1100a000 0x0 0x1000>;
		interrupts = <0x0 0x76 0x8>;
		clocks = <0x5 0x1c>;
		clock-names = "main";
		clock-frequency = <0x67f3540>;
		clock-div = <0x1>;
		linux,phandle = <0x6a>;
		phandle = <0x6a>;
	};

	spi@11010000 {
		compatible = "mediatek,mt6763-spi";
		cell-index = <0x1>;
		spi-padmacro = <0x0>;
		dma_addrmask = <0x24>;
		reg = <0x0 0x11010000 0x0 0x1000>;
		interrupts = <0x0 0x7a 0x8>;
		clocks = <0x5 0x39>;
		clock-names = "main";
		clock-frequency = <0x67f3540>;
		clock-div = <0x1>;
		linux,phandle = <0x6b>;
		phandle = <0x6b>;
	};

	spi@11012000 {
		compatible = "mediatek,mt6763-spi";
		cell-index = <0x2>;
		spi-padmacro = <0x0>;
		dma_addrmask = <0x24>;
		reg = <0x0 0x11012000 0x0 0x1000>;
		interrupts = <0x0 0x80 0x8>;
		clocks = <0x5 0x3c>;
		clock-names = "main";
		clock-frequency = <0x67f3540>;
		clock-div = <0x1>;
		linux,phandle = <0x6c>;
		phandle = <0x6c>;
	};

	spi@11013000 {
		compatible = "mediatek,mt6763-spi";
		cell-index = <0x3>;
		spi-padmacro = <0x0>;
		dma_addrmask = <0x24>;
		reg = <0x0 0x11013000 0x0 0x1000>;
		interrupts = <0x0 0x81 0x8>;
		clocks = <0x5 0x3d>;
		clock-names = "main";
		clock-frequency = <0x67f3540>;
		clock-div = <0x1>;
		linux,phandle = <0x6d>;
		phandle = <0x6d>;
	};

	spi@11018000 {
		compatible = "mediatek,mt6763-spi";
		cell-index = <0x4>;
		spi-padmacro = <0x0>;
		dma_addrmask = <0x24>;
		reg = <0x0 0x11018000 0x0 0x1000>;
		interrupts = <0x0 0x86 0x8>;
		clocks = <0x5 0x4c>;
		clock-names = "main";
		clock-frequency = <0x67f3540>;
		clock-div = <0x1>;
		linux,phandle = <0x6e>;
		phandle = <0x6e>;
	};

	spi@11019000 {
		compatible = "mediatek,mt6763-spi";
		cell-index = <0x5>;
		spi-padmacro = <0x0>;
		dma_addrmask = <0x24>;
		reg = <0x0 0x11019000 0x0 0x1000>;
		interrupts = <0x0 0x87 0x8>;
		clocks = <0x5 0x4d>;
		clock-names = "main";
		clock-frequency = <0x67f3540>;
		clock-div = <0x1>;
		linux,phandle = <0x6f>;
		phandle = <0x6f>;
	};

	therm_ctrl@1100b000 {
		compatible = "mediatek,therm_ctrl";
		reg = <0x0 0x1100b000 0x0 0x1000>;
		interrupts = <0x0 0x4e 0x8>;
		clocks = <0x5 0xa>;
		clock-names = "therm-main";
	};

	eem_fsm@1100b000 {
		compatible = "mediatek,eem_fsm";
		reg = <0x0 0x1100b000 0x0 0x1000>;
		interrupts = <0x0 0x7d 0x8>;
		clocks = <0x2e 0x7 0x2e 0x4 0x2e 0xb 0x2e 0xa>;
		clock-names = "mfg-async", "mfg", "mfg-core0", "mfg-core1";
	};

	btif@1100c000 {
		compatible = "mediatek,btif";
		#address-cells = <0x2>;
		#size-cells = <0x2>;
		reg = <0x0 0x1100c000 0x0 0x1000 0x0 0x11000900 0x0 0x80 0x0 0x11000980 0x0 0x80>;
		interrupts = <0x0 0x70 0x8 0x0 0x5f 0x8 0x0 0x60 0x8>;
		clocks = <0x5 0x1b 0x5 0x2b>;
		clock-names = "btifc", "apdmac";
	};

	irtx@1100d000 {
		compatible = "mediatek,irtx";
		reg = <0x0 0x1100d000 0x0 0x1000>;
		interrupts = <0x0 0x7f 0x0>;
	};

	disp_pwm0@1100e000 {
		compatible = "mediatek,disp_pwm0";
		reg = <0x0 0x1100e000 0x0 0x1000>;
		interrupts = <0x0 0x7e 0x8>;
	};

	usb0@11200000 {
		compatible = "mediatek,mt6763-usb20";
		reg = <0x0 0x11200000 0x0 0x10000 0x0 0x11f40000 0x0 0x10000>;
		interrupts = <0x0 0x49 0x8>;
		mode = <0x2>;
		multipoint = <0x1>;
		num_eps = <0x10>;
		clocks = <0x5 0x8>;
		clock-names = "usb0";
	};

	usb_sif@11210000 {
		compatible = "mediatek,usb_sif";
		reg = <0x0 0x11210000 0x0 0x1000>;
	};

	audio@11220000 {
		compatible = "mediatek,audio", "syscon";
		reg = <0x0 0x11220000 0x0 0x1000>;
		#clock-cells = <0x1>;
		linux,phandle = <0x3e>;
		phandle = <0x3e>;
	};

	mt_soc_dl1_pcm@11220000 {
		compatible = "mediatek,mt_soc_pcm_dl1";
		reg = <0x0 0x11220000 0x0 0x1000>;
		interrupts = <0x0 0x99 0x8>;
		clocks = <0x3e 0xa 0x3e 0x3 0x3e 0x2 0x3e 0x4 0x3e 0x8 0x3e 0x7 0x3e 0x5 0x3e 0x6 0x3e 0x1 0x2e 0x8 0x5 0x30 0x5 0x38 0x40 0x10 0x40 0x11 0x40 0x2f 0x40 0x18 0x40 0x4d 0x40 0x19 0x40 0x51 0x40 0x24 0x40 0x50 0x40 0x25 0x40 0x54 0x41>;
		clock-names = "aud_afe_clk", "aud_dac_clk", "aud_dac_predis_clk", "aud_adc_clk", "aud_apll22m_clk", "aud_apll24m_clk", "aud_apll1_tuner_clk", "aud_apll2_tuner_clk", "aud_tml_clk", "scp_sys_audio", "aud_infra_clk", "mtkaif_26m_clk", "top_mux_audio", "top_mux_audio_int", "top_sys_pll1_d4", "top_mux_aud_1", "top_apll1_ck", "top_mux_aud_2", "top_apll2_ck", "top_mux_aud_eng1", "top_apll1_d8", "top_mux_aud_eng2", "top_apll2_d8", "top_clk26m_clk";
		linux,phandle = <0x70>;
		phandle = <0x70>;
	};

	audio_sram@11221000 {
		compatible = "mediatek,audio_sram";
		reg = <0x0 0x11221000 0x0 0xc000>;
	};

	ufshci@11270000 {
		compatible = "mediatek,ufshci";
		reg = <0x0 0x11270000 0x0 0x2300>;
		interrupts = <0x0 0x53 0x8>;
		clocks = <0x5 0x4f 0x5 0x40>;
		clock-names = "ufs0-clock", "ufs0-mp-clk";
		freq-table-hz = <0x0 0x0 0x0 0x0>;
		vcc-supply = <0x4>;
		vcc-fixed-regulator;
		mediatek,auto-hibern8-timer = <0xa>;
		mediatek,spm-level = <0x3>;
		mediatek,rpm-enable = <0x1>;
		mediatek,rpm-autosuspend-delay = <0x7d0>;
		mediatek,rpm-level = <0x3>;
		pinctrl-names = "state_va09_on", "state_va09_off";
		pinctrl-0 = <0x42>;
		pinctrl-1 = <0x43>;
		status = "okay";
		linux,phandle = <0x71>;
		phandle = <0x71>;
	};

	ufs_mphy@11fa0000 {
		compatible = "mediatek,ufs_mphy";
		reg = <0x0 0x11fa0000 0x0 0xc000>;
	};

	ca9peri@10e00000 {
		compatible = "mediatek,ca9peri";
		reg = <0x0 0x10e00000 0x0 0x1000>;
	};

	l2c@10f00000 {
		compatible = "mediatek,l2c";
		reg = <0x0 0x10f00000 0x0 0x1000>;
	};

	efusec@11f10000 {
		compatible = "mediatek,efusec";
		reg = <0x0 0x11f10000 0x0 0x1000>;
	};

	mfgcfg@13000000 {
		compatible = "mediatek,mfgcfg", "syscon";
		reg = <0x0 0x13000000 0x0 0x1000>;
		#clock-cells = <0x1>;
		linux,phandle = <0x44>;
		phandle = <0x44>;
	};

	mali@13040000 {
		compatible = "arm,malit860", "arm,mali-t86x", "arm,malit8xx", "arm,mali-midgard";
		reg = <0x0 0x13040000 0x0 0x4000>;
		interrupts = <0x0 0x104 0x8 0x0 0x103 0x8 0x0 0x102 0x8>;
		interrupt-names = "JOB", "MMU", "GPU";
		clocks = <0x44 0x1 0x2e 0x7 0x2e 0x4 0x2e 0xb 0x2e 0xa>;
		clock-names = "subsys-mfg-cg", "mtcmos-mfg-async", "mtcmos-mfg", "mtcmos-mfg-core0", "mtcmos-mfg-core1";
	};

	mali_tb@1307f000 {
		compatible = "mediatek,mali_tb";
		reg = <0x0 0x1307f000 0x0 0x1000>;
	};

	mfg_dfp_60@13020000 {
		compatible = "mediatek,mfg_dfp_60";
		reg = <0x0 0x13020000 0x0 0x1000>;
		interrupts = <0x0 0x106 0x8>;
	};

	gpufreq {
		compatible = "mediatek,mt6763-gpufreq";
		clocks = <0x40 0x6 0x40 0x67 0x41>;
		clock-names = "clk_mux", "clk_main_parent", "clk_sub_parent";
	};

	mmsys_config@14000000 {
		compatible = "mediatek,mmsys_config", "syscon";
		reg = <0x0 0x14000000 0x0 0x1000>;
		interrupts = <0x0 0xe4 0x8>;
		#clock-cells = <0x1>;
		clocks = <0x2f 0xb 0x2f 0x26>;
		clock-names = "CAM_MDP_TX", "CAM_MDP_RX";
		linux,phandle = <0x2f>;
		phandle = <0x2f>;
	};

	nfc {
		compatible = "mediatek,nfc-gpio-v2";
		gpio-rst = <0x19>;
		gpio-rst-std = <0xb 0x19 0x0>;
		gpio-irq = <0x1a>;
		gpio-irq-std = <0xb 0x1a 0x0>;
		linux,phandle = <0x72>;
		phandle = <0x72>;
	};

	gps {
		compatible = "mediatek,gps";
	};

	flashlight_core {
		compatible = "mediatek,flashlight_core";
		linux,phandle = <0x73>;
		phandle = <0x73>;
	};

	irq_nfc {
		compatible = "mediatek,irq_nfc-eint";
		linux,phandle = <0x74>;
		phandle = <0x74>;
	};

	mtkfb@0 {
		compatible = "mediatek,mtkfb";
		linux,phandle = <0x75>;
		phandle = <0x75>;
	};

	als_ps@0 {
		compatible = "mediatek,als_ps";
		linux,phandle = <0x76>;
		phandle = <0x76>;
	};

	mse {
		compatible = "mediatek,fix_build_error";
		linux,phandle = <0x77>;
		phandle = <0x77>;
	};

	gyro {
		compatible = "mediatek,fix_build_error";
		linux,phandle = <0x78>;
		phandle = <0x78>;
	};

	touch {
		compatible = "mediatek,mt6763-touch";
		linux,phandle = <0x79>;
		phandle = <0x79>;
	};

	accdet {
		compatible = "mediatek,pmic-accdet";
		linux,phandle = <0x7a>;
		phandle = <0x7a>;
	};

	mt6356_gauge {
		compatible = "mediatek,mt6356_gauge";
		gauge_name = "gauge";
		alias_name = "MT6356";
	};

	gauge_timer {
		compatible = "mediatek,gauge_timer_service";
	};

	dispsys@14000000 {
		compatible = "mediatek,dispsys";
		clocks = <0x2e 0x3 0x2f 0x1 0x2f 0x2 0x2f 0x3 0x2f 0x4 0x2f 0x5 0x2f 0x6 0x2f 0x7 0x2f 0x8 0x2f 0x9 0x2f 0xa 0x2f 0x15 0x2f 0x16 0x2f 0x17 0x2f 0x18 0x2f 0x19 0x2f 0x1a 0x2f 0x1b 0x2f 0x1c 0x2f 0x1d 0x2f 0x1e 0x2f 0x1f 0x2f 0x20 0x2f 0x21 0x2f 0x22 0x2f 0x23 0x2f 0x24 0x2f 0x28 0x2f 0x2a 0x40 0x2 0x40 0x1a 0x5 0x36 0x41 0x40 0x46 0x40 0x61 0x40 0x63 0x40 0x16 0x40 0x56 0x40 0x57 0x40 0x58 0x40 0x59 0x40 0x55>;
		clock-names = "MMSYS_MTCMOS", "MMSYS_SMI_COMMON", "MMSYS_SMI_LARB0", "MMSYS_SMI_LARB1", "MMSYS_GALS_COMM0", "MMSYS_GALS_COMM1", "MMSYS_GALS_VENC2MM", "MMSYS_GALS_VDEC2MM", "MMSYS_GALS_IMG2MM", "MMSYS_GALS_CAM2MM", "MMSYS_GALS_IPU2MM", "MMSYS_DISP_OVL0", "MMSYS_DISP_OVL0_2L", "MMSYS_DISP_OVL1_2L", "MMSYS_DISP_RDMA0", "MMSYS_DISP_RDMA1", "MMSYS_DISP_WDMA0", "MMSYS_DISP_COLOR0", "MMSYS_DISP_CCORR0", "MMSYS_DISP_AAL0", "MMSYS_DISP_GAMMA0", "MMSYS_DISP_DITHER0", "MMSYS_DISP_SPLIT", "MMSYS_DSI0_MM_CK", "MMSYS_DSI0_IF_CK", "MMSYS_DPI_MM_CK", "MMSYS_DPI_IF_CK", "MMSYS_26M", "MMSYS_DISP_RSZ", "TOP_MUX_MM", "TOP_MUX_DISP_PWM", "DISP_PWM", "TOP_26M", "TOP_UNIVPLL2_D4", "TOP_OSC_D4", "TOP_OSC_D16", "MUX_DPI0", "TVDPLL_D2", "TVDPLL_D4", "TVDPLL_D8", "TVDPLL_D16", "DPI_CK";
		linux,phandle = <0x7b>;
		phandle = <0x7b>;
	};

	dsi_te {
		compatible = "mediatek, dsi_te-eint";
		status = "disabled";
		linux,phandle = <0x7c>;
		phandle = <0x7c>;
	};

	dsi_te_1 {
		compatible = "mediatek, dsi_te_1-eint";
		status = "disabled";
		linux,phandle = <0x7d>;
		phandle = <0x7d>;
	};

	mhl@0 {
		compatible = "mediatek,extd_dev";
		linux,phandle = <0x7e>;
		phandle = <0x7e>;
	};

	eint_hdmi_hpd@0 {
		compatible = "mediatek,hdmi_dev";
		linux,phandle = <0x7f>;
		phandle = <0x7f>;
	};

	mdp_rdma0@14001000 {
		compatible = "mediatek,mdp_rdma0";
		reg = <0x0 0x14001000 0x0 0x1000>;
		interrupts = <0x0 0xcf 0x8>;
		clocks = <0x2f 0xd>;
		clock-names = "MDP_RDMA0";
		linux,phandle = <0x31>;
		phandle = <0x31>;
	};

	mdp_rdma1@14002000 {
		compatible = "mediatek,mdp_rdma1";
		reg = <0x0 0x14002000 0x0 0x1000>;
		interrupts = <0x0 0xd0 0x8>;
		clocks = <0x2f 0xe>;
		clock-names = "MDP_RDMA1";
		linux,phandle = <0x32>;
		phandle = <0x32>;
	};

	mdp_rsz0@14003000 {
		compatible = "mediatek,mdp_rsz0";
		reg = <0x0 0x14003000 0x0 0x1000>;
		interrupts = <0x0 0xd1 0x8>;
		clocks = <0x2f 0xf>;
		clock-names = "MDP_RSZ0";
		linux,phandle = <0x33>;
		phandle = <0x33>;
	};

	mdp_rsz1@14004000 {
		compatible = "mediatek,mdp_rsz1";
		reg = <0x0 0x14004000 0x0 0x1000>;
		interrupts = <0x0 0xd2 0x8>;
		clocks = <0x2f 0x10>;
		clock-names = "MDP_RSZ1";
		linux,phandle = <0x34>;
		phandle = <0x34>;
	};

	mdp_wrot0@14005000 {
		compatible = "mediatek,mdp_wrot0";
		reg = <0x0 0x14005000 0x0 0x1000>;
		interrupts = <0x0 0xd4 0x8>;
		clocks = <0x2f 0x12>;
		clock-names = "MDP_WROT0";
		linux,phandle = <0x35>;
		phandle = <0x35>;
	};

	mdp_wdma@14006000 {
		compatible = "mediatek,mdp_wdma";
		reg = <0x0 0x14006000 0x0 0x1000>;
		interrupts = <0x0 0xd5 0x8>;
		clocks = <0x2f 0x13>;
		clock-names = "MDP_WDMA";
		linux,phandle = <0x36>;
		phandle = <0x36>;
	};

	mdp_tdshp@14007000 {
		compatible = "mediatek,mdp_tdshp";
		reg = <0x0 0x14007000 0x0 0x1000>;
		interrupts = <0x0 0xd3 0x8>;
		clocks = <0x2f 0x11>;
		clock-names = "MDP_TDSHP";
		linux,phandle = <0x37>;
		phandle = <0x37>;
	};

	disp_ovl0@14008000 {
		compatible = "mediatek,disp_ovl0";
		reg = <0x0 0x14008000 0x0 0x1000>;
		interrupts = <0x0 0xd6 0x8>;
		clocks = <0x2f 0x15>;
		clock-names = "DISP_OVL0";
		linux,phandle = <0x39>;
		phandle = <0x39>;
	};

	disp_ovl0_2l@14009000 {
		compatible = "mediatek,disp_ovl0_2l";
		reg = <0x0 0x14009000 0x0 0x1000>;
		interrupts = <0x0 0xd7 0x8>;
		clocks = <0x2f 0x16>;
		clock-names = "DISP_OVL0_2L";
		linux,phandle = <0x3a>;
		phandle = <0x3a>;
	};

	disp_ovl1_2l@1400a000 {
		compatible = "mediatek,disp_ovl1_2l";
		reg = <0x0 0x1400a000 0x0 0x1000>;
		interrupts = <0x0 0xd8 0x8>;
		clocks = <0x2f 0x17>;
		clock-names = "DISP_OVL1_2L";
		linux,phandle = <0x3b>;
		phandle = <0x3b>;
	};

	disp_rdma0@1400b000 {
		compatible = "mediatek,disp_rdma0";
		reg = <0x0 0x1400b000 0x0 0x1000>;
		interrupts = <0x0 0xd9 0x8>;
	};

	disp_rdma1@1400c000 {
		compatible = "mediatek,disp_rdma1";
		reg = <0x0 0x1400c000 0x0 0x1000>;
		interrupts = <0x0 0xda 0x8>;
	};

	disp_wdma0@1400d000 {
		compatible = "mediatek,disp_wdma0";
		reg = <0x0 0x1400d000 0x0 0x1000>;
		interrupts = <0x0 0xdb 0x8>;
	};

	disp_color0@1400e000 {
		compatible = "mediatek,disp_color0";
		reg = <0x0 0x1400e000 0x0 0x1000>;
		interrupts = <0x0 0xdc 0x8>;
		clocks = <0x2f 0x1b>;
		clock-names = "MDP_COLOR";
		linux,phandle = <0x38>;
		phandle = <0x38>;
	};

	disp_ccorr0@1400f000 {
		compatible = "mediatek,disp_ccorr0";
		reg = <0x0 0x1400f000 0x0 0x1000>;
		interrupts = <0x0 0xdd 0x8>;
	};

	disp_aal0@14010000 {
		compatible = "mediatek,disp_aal0";
		reg = <0x0 0x14010000 0x0 0x1000>;
		interrupts = <0x0 0xde 0x8>;
		aal_support = <0x1>;
		linux,phandle = <0x80>;
		phandle = <0x80>;
	};

	disp_gamma0@14011000 {
		compatible = "mediatek,disp_gamma0";
		reg = <0x0 0x14011000 0x0 0x1000>;
		interrupts = <0x0 0xdf 0x8>;
	};

	disp_dither0@14012000 {
		compatible = "mediatek,disp_dither0";
		reg = <0x0 0x14012000 0x0 0x1000>;
		interrupts = <0x0 0xe0 0x8>;
	};

	disp_split@14013000 {
		compatible = "mediatek,disp_split";
		reg = <0x0 0x14013000 0x0 0x1000>;
	};

	dsi0@14014000 {
		compatible = "mediatek,dsi0";
		reg = <0x0 0x14014000 0x0 0x1000>;
		interrupts = <0x0 0xe1 0x8>;
	};

	dpi0@14015000 {
		compatible = "mediatek,dpi0";
		reg = <0x0 0x14015000 0x0 0x1000>;
		interrupts = <0x0 0xe2 0x8>;
	};

	disp_mutex@14016000 {
		compatible = "mediatek,disp_mutex";
		reg = <0x0 0x14016000 0x0 0x1000>;
		interrupts = <0x0 0xce 0x8>;
		linux,phandle = <0x30>;
		phandle = <0x30>;
	};

	smi_larb0@14017000 {
		compatible = "mediatek,smi_larb0";
		reg = <0x0 0x14017000 0x0 0x1000>;
		interrupts = <0x0 0xe5 0x8>;
		clocks = <0x2e 0x3 0x2f 0x2>;
		clock-names = "mtcmos-mm", "mm-larb0";
		linux,phandle = <0x45>;
		phandle = <0x45>;
	};

	smi_common@14019000 {
		compatible = "mediatek,smi_common";
		reg = <0x0 0x14019000 0x0 0x1000>;
		larbs = <0x45 0x46 0x47 0x48>;
		clocks = <0x2e 0x3 0x2f 0x4 0x2f 0x5 0x2f 0x1 0x40 0x66 0x40 0x4 0x40 0x66 0x40 0x55>;
		clock-names = "mtcmos-mm", "smi-common-gals0", "smi-common-gals1", "smi-common", "MMDVFS_CLK_TOP_MMPLL_CK", "MMDVFS_CLK_MUX_TOP_CAM_SEL", "mmdvfs_clk_top_mmpll_ck", "mmdvfs_clk_top_tvdpll_ck";
	};

	disp_rsz@1401a000 {
		compatible = "mediatek,disp_rsz";
		reg = <0x0 0x1401a000 0x0 0x1000>;
	};

	disp_dbi@1401b000 {
		compatible = "mediatek,disp_dbi";
		reg = <0x0 0x1401b000 0x0 0x1000>;
	};

	i2c@1401c000 {
		compatible = "mediatek,i2c";
		reg = <0x0 0x1401c000 0x0 0x1000>;
	};

	dsi1@1401d000 {
		compatible = "mediatek,dsi1";
		reg = <0x0 0x1401d000 0x0 0x1000>;
	};

	mdp_wrot1@1401e000 {
		compatible = "mediatek,mdp_wrot1";
		reg = <0x0 0x1401e000 0x0 0x1000>;
	};

	vdec_gcon@17000000 {
		compatible = "mediatek,vdec_gcon";
		reg = <0x0 0x17000000 0x0 0x1000>;
		clocks = <0x49 0x4 0x49 0x2 0x2e 0x6 0x2e 0x6>;
		clock-names = "MT_CG_VDEC", "MT_CG_VENC", "MT_SCP_SYS_VDE", "MT_SCP_SYS_VEN";
		#clock-cells = <0x1>;
	};

	vdec@17040000 {
		compatible = "mediatek,vdec";
		reg = <0x0 0x17040000 0x0 0x10000>;
		interrupts = <0x0 0xe9 0x8>;
	};

	vld@17040000 {
		compatible = "mediatek,vld";
		reg = <0x0 0x17040000 0x0 0x1000>;
	};

	vld_top@17040800 {
		compatible = "mediatek,vld_top";
		reg = <0x0 0x17040800 0x0 0x1000>;
	};

	mc@17041000 {
		compatible = "mediatek,mc";
		reg = <0x0 0x17041000 0x0 0x1000>;
	};

	avc_vld@17042000 {
		compatible = "mediatek,avc_vld";
		reg = <0x0 0x17042000 0x0 0x1000>;
	};

	avc_mv@17043000 {
		compatible = "mediatek,avc_mv";
		reg = <0x0 0x17043000 0x0 0x1000>;
	};

	vdec_pp@17044000 {
		compatible = "mediatek,vdec_pp";
		reg = <0x0 0x17044000 0x0 0x1000>;
	};

	vdtop@17045000 {
		compatible = "mediatek,vdtop";
		reg = <0x0 0x17045000 0x0 0x1000>;
	};

	vp6@17046000 {
		compatible = "mediatek,vp6";
		reg = <0x0 0x17046000 0x0 0x1000>;
	};

	hevc_vld@17048000 {
		compatible = "mediatek,hevc_vld";
		reg = <0x0 0x17048000 0x0 0x1000>;
	};

	vp8_vld@17046800 {
		compatible = "mediatek,vp8_vld";
		reg = <0x0 0x17046800 0x0 0x1000>;
	};

	vld2@17047800 {
		compatible = "mediatek,vld2";
		reg = <0x0 0x17047800 0x0 0x1000>;
	};

	mc_vmmu@17048000 {
		compatible = "mediatek,mc_vmmu";
		reg = <0x0 0x17048000 0x0 0x1000>;
	};

	pp_vmmu@17049000 {
		compatible = "mediatek,pp_vmmu";
		reg = <0x0 0x17049000 0x0 0x1000>;
	};

	venc_gcon@17000000 {
		compatible = "mediatek,venc_gcon", "syscon";
		reg = <0x0 0x17000000 0x0 0x1000>;
		#clock-cells = <0x1>;
		linux,phandle = <0x49>;
		phandle = <0x49>;
	};

	smi_larb3@17010000 {
		compatible = "mediatek,smi_larb3";
		reg = <0x0 0x17010000 0x0 0x1000>;
		interrupts = <0x0 0xe7 0x8>;
		clocks = <0x2e 0x6 0x49 0x1 0x49 0x2>;
		clock-names = "mtcmos-ven", "venc-larb", "venc-venc";
		linux,phandle = <0x48>;
		phandle = <0x48>;
	};

	venc@17020000 {
		compatible = "mediatek,venc";
		reg = <0x0 0x17020000 0x0 0x1000>;
		interrupts = <0x0 0xe6 0x8>;
		linux,phandle = <0x3c>;
		phandle = <0x3c>;
	};

	venc_jpg@17030000 {
		compatible = "mediatek,venc_jpg";
		reg = <0x0 0x17030000 0x0 0x1000>;
		interrupts = <0x0 0xe8 0x8>;
		clocks = <0x2f 0x1 0x2e 0x3 0x2e 0x6 0x49 0x1 0x49 0x3>;
		clock-names = "MT_CG_SMI_COMMON", "MT_CG_SCP_SYS_MM0", "MT_CG_SCP_SYS_VEN", "MT_CG_VENC_LARB", "MT_CG_VENC_JPGENC";
	};

	mbist@17050000 {
		compatible = "mediatek,mbist";
		reg = <0x0 0x17050000 0x0 0x1000>;
	};

	mjc_config@12000000 {
		compatible = "mediatek,mjc_config";
		reg = <0x0 0x12000000 0x0 0x1000>;
	};

	mjc_top@12001000 {
		compatible = "mediatek,mjc_top";
		reg = <0x0 0x12001000 0x0 0x1000>;
	};

	imgsys1_dfp@1502e000 {
		compatible = "mediatek,imgsys1_dfp";
		reg = <0x0 0x1502e000 0x0 0x1000>;
	};

	imgsys@15020000 {
		compatible = "mediatek,imgsys", "syscon";
		reg = <0x0 0x15020000 0x0 0x1000>;
		#clock-cells = <0x1>;
		clocks = <0x2e 0x3 0x2e 0x5 0x2e 0x9 0x4a 0x5 0x4b 0x3 0x4b 0x4 0x4b 0x5 0x4b 0x6 0x4b 0x7 0x4b 0x8>;
		clock-names = "ISP_SCP_SYS_DIS", "ISP_SCP_SYS_ISP", "ISP_SCP_SYS_CAM", "IMG_DIP", "CAMSYS_CAM_CGPDN", "CAMSYS_CAMTG_CGPDN", "CAMSYS_SENINF_CGPDN", "CAMSYS_CAMSV0_CGPDN", "CAMSYS_CAMSV1_CGPDN", "CAMSYS_CAMSV2_CGPDN";
		linux,phandle = <0x4a>;
		phandle = <0x4a>;
	};

	smi_larb1@15021000 {
		compatible = "mediatek,smi_larb1";
		reg = <0x0 0x15021000 0x0 0x1000>;
		interrupts = <0x0 0xfa 0x8>;
		clocks = <0x2e 0x5 0x4a 0x7>;
		clock-names = "mtcmos-isp", "img-larb1";
		linux,phandle = <0x46>;
		phandle = <0x46>;
	};

	dip1@15022000 {
		compatible = "mediatek,dip1";
		reg = <0x0 0x15022000 0x0 0x3000>;
		interrupts = <0x0 0xfb 0x8>;
	};

	dpe@15028000 {
		compatible = "mediatek,dpe";
		reg = <0x0 0x15028000 0x0 0x1000>;
	};

	dpe_dma@15028000 {
		compatible = "mediatek,dpe_dma";
		reg = <0x0 0x15028000 0x0 0x1000>;
	};

	rsc@15029000 {
		compatible = "mediatek,rsc";
		reg = <0x0 0x15029000 0x0 0x1000>;
	};

	wpe@1502a000 {
		compatible = "mediatek,wpe";
		reg = <0x0 0x1502a000 0x0 0x1000>;
	};

	fdvt@1502b000 {
		compatible = "mediatek,fdvt";
		reg = <0x0 0x1502b000 0x0 0x1000>;
		interrupts = <0x0 0xfc 0x8>;
		clocks = <0x4a 0x3>;
		clock-names = "IMG_FDVT";
	};

	fdvt_dma@1502b000 {
		compatible = "mediatek,fdvt_dma";
		reg = <0x0 0x1502b000 0x0 0x1000>;
	};

	gepf@1502c000 {
		compatible = "mediatek,gepf";
		reg = <0x0 0x1502c000 0x0 0x1000>;
	};

	gepf_dma@1502c000 {
		compatible = "mediatek,gepf_dma";
		reg = <0x0 0x1502c000 0x0 0x1000>;
	};

	eaf@1502d000 {
		compatible = "mediatek,eaf";
		reg = <0x0 0x1502d000 0x0 0x1000>;
	};

	eaf_dma@1502d000 {
		compatible = "mediatek,eaf_dma";
		reg = <0x0 0x1502d000 0x0 0x1000>;
	};

	imgsys1_vad@1502e000 {
		compatible = "mediatek,imgsys1_vad";
		reg = <0x0 0x1502e000 0x0 0x1000>;
	};

	camsys@1a000000 {
		compatible = "mediatek,camsys", "syscon";
		reg = <0x0 0x1a000000 0x0 0x1000>;
		#clock-cells = <0x1>;
		linux,phandle = <0x4b>;
		phandle = <0x4b>;
	};

	smi_larb2@1a001000 {
		compatible = "mediatek,smi_larb2";
		reg = <0x0 0x1a001000 0x0 0x1000>;
		interrupts = <0x0 0xf6 0x8>;
		clocks = <0x2e 0x9 0x2f 0x9 0x4b 0x1>;
		clock-names = "mtcmos-cam", "gals-cam2mm", "cam-larb2";
		linux,phandle = <0x47>;
		phandle = <0x47>;
	};

	cam1@1a003000 {
		compatible = "mediatek,cam1";
		reg = <0x0 0x1a003000 0x0 0x1000>;
		interrupts = <0x0 0xeb 0x8>;
	};

	cam2@1a004000 {
		compatible = "mediatek,cam2";
		reg = <0x0 0x1a004000 0x0 0x1000>;
		interrupts = <0x0 0xec 0x8>;
	};

	cam3@1a005000 {
		compatible = "mediatek,cam3";
		reg = <0x0 0x1a005000 0x0 0x1000>;
		interrupts = <0x0 0xed 0x8>;
	};

	cam4@1a006000 {
		compatible = "mediatek,cam4";
		reg = <0x0 0x1a006000 0x0 0x1000>;
		interrupts = <0x0 0xee 0x8>;
	};

	cam5@1a024000 {
		compatible = "mediatek,cam5";
		reg = <0x0 0x1a024000 0x0 0x1000>;
		interrupts = <0x0 0xef 0x8>;
	};

	cam6@1a025000 {
		compatible = "mediatek,cam6";
		reg = <0x0 0x1a025000 0x0 0x1000>;
	};

	camsv_top@1a050000 {
		compatible = "mediatek,camsv_top";
		reg = <0x0 0x1a050000 0x0 0x1000>;
	};

	camsv1@1a050000 {
		compatible = "mediatek,camsv1";
		reg = <0x0 0x1a050000 0x0 0x1000>;
		interrupts = <0x0 0xf1 0x8>;
	};

	camsv2@1a051000 {
		compatible = "mediatek,camsv2";
		reg = <0x0 0x1a051000 0x0 0x1000>;
		interrupts = <0x0 0xf0 0x8>;
	};

	camsv3@1a052000 {
		compatible = "mediatek,camsv3";
		reg = <0x0 0x1a052000 0x0 0x1000>;
		interrupts = <0x0 0xf3 0x8>;
	};

	camsv4@1a053000 {
		compatible = "mediatek,camsv4";
		reg = <0x0 0x1a053000 0x0 0x1000>;
		interrupts = <0x0 0xf2 0x8>;
	};

	camsv5@1a054000 {
		compatible = "mediatek,camsv5";
		reg = <0x0 0x1a054000 0x0 0x1000>;
	};

	camsv6@1a055000 {
		compatible = "mediatek,camsv6";
		reg = <0x0 0x1a055000 0x0 0x1000>;
	};

	tsf@1a0b1000 {
		compatible = "mediatek,tsf";
		reg = <0x0 0x1a0b1000 0x0 0x1000>;
		clocks = <0x4b 0x9>;
		clock-names = "TSF_CLK_CAM_CCU";
		interrupts = <0x0 0xf7 0x8>;
	};

	camsys_dfp@1a008000 {
		compatible = "mediatek,camsys_dfp";
		reg = <0x0 0x1a008000 0x0 0x1000>;
	};

	kd_camera_hw1@1a040000 {
		compatible = "mediatek,camera_hw";
		reg = <0x0 0x1a040000 0x0 0x1000>;
		clocks = <0x40 0x7 0x40 0x23 0x40 0x47 0x40 0x3f 0x40 0x48 0x40 0x49 0x40 0x40 0x40 0x41 0x40 0x3e 0x41 0x6a>;
		clock-names = "TOP_CAMTG_SEL", "TOP_CAMTG2_SEL", "TOP_UNIVPLL2_D8", "TOP_UNIVPLL_D52", "TOP_UNIVPLL2_D16", "TOP_UNIVPLL2_D32", "TOP_UNIVPLL_D104", "TOP_UNIVPLL_D208", "TOP_UNIVPLL_D26", "TOP_CLK26M";
		linux,phandle = <0x81>;
		phandle = <0x81>;
	};

	kd_camera_hw2@1a040000 {
		compatible = "mediatek,camera_hw2";
		reg = <0x0 0x1a040000 0x0 0x1000>;
		linux,phandle = <0x82>;
		phandle = <0x82>;
	};

	seninf1_csi2@1a040000 {
		compatible = "mediatek,seninf1_csi2";
		reg = <0x0 0x1a040000 0x0 0x1000>;
	};

	seninf2_csi2@1a041000 {
		compatible = "mediatek,seninf2_csi2";
		reg = <0x0 0x1a041000 0x0 0x1000>;
	};

	seninf3_csi2@1a042000 {
		compatible = "mediatek,seninf3_csi2";
		reg = <0x0 0x1a042000 0x0 0x1000>;
	};

	seninf4_csi2@1a043000 {
		compatible = "mediatek,seninf4_csi2";
		reg = <0x0 0x1a043000 0x0 0x1000>;
	};

	seninf5_csi2@1a044000 {
		compatible = "mediatek,seninf5_csi2";
		reg = <0x0 0x1a044000 0x0 0x1000>;
	};

	seninf1@1a040000 {
		compatible = "mediatek,seninf1";
		reg = <0x0 0x1a040000 0x0 0x1000>;
	};

	seninf2@1a041000 {
		compatible = "mediatek,seninf2";
		reg = <0x0 0x1a041000 0x0 0x1000>;
	};

	seninf3@1a042000 {
		compatible = "mediatek,seninf3";
		reg = <0x0 0x1a042000 0x0 0x1000>;
	};

	seninf4@1a043000 {
		compatible = "mediatek,seninf4";
		reg = <0x0 0x1a043000 0x0 0x1000>;
	};

	seninf5@1a044000 {
		compatible = "mediatek,seninf5";
		reg = <0x0 0x1a044000 0x0 0x1000>;
	};

	seninf1_tg@1a040000 {
		compatible = "mediatek,seninf1_tg";
		reg = <0x0 0x1a040000 0x0 0x1000>;
	};

	seninf2_tg@1a041000 {
		compatible = "mediatek,seninf2_tg";
		reg = <0x0 0x1a041000 0x0 0x1000>;
	};

	seninf3_tg@1a042000 {
		compatible = "mediatek,seninf3_tg";
		reg = <0x0 0x1a042000 0x0 0x1000>;
	};

	seninf4_tg@1a043000 {
		compatible = "mediatek,seninf4_tg";
		reg = <0x0 0x1a043000 0x0 0x1000>;
	};

	seninf5_tg@1a044000 {
		compatible = "mediatek,seninf5_tg";
		reg = <0x0 0x1a044000 0x0 0x1000>;
	};

	seninf_top@1a040000 {
		compatible = "mediatek,seninf_top";
		reg = <0x0 0x1a040000 0x0 0x1000>;
		interrupts = <0x0 0xea 0x8>;
	};

	seninf1_mux@1a040000 {
		compatible = "mediatek,seninf1_mux";
		reg = <0x0 0x1a040000 0x0 0x1000>;
	};

	seninf2_mux@1a041000 {
		compatible = "mediatek,seninf2_mux";
		reg = <0x0 0x1a041000 0x0 0x1000>;
	};

	seninf3_mux@1a042000 {
		compatible = "mediatek,seninf3_mux";
		reg = <0x0 0x1a042000 0x0 0x1000>;
	};

	seninf4_mux@1a043000 {
		compatible = "mediatek,seninf4_mux";
		reg = <0x0 0x1a043000 0x0 0x1000>;
	};

	seninf5_mux@1a044000 {
		compatible = "mediatek,seninf5_mux";
		reg = <0x0 0x1a044000 0x0 0x1000>;
	};

	seninf6_mux@1a045000 {
		compatible = "mediatek,seninf6_mux";
		reg = <0x0 0x1a045000 0x0 0x1000>;
	};

	seninf7_mux@1a046000 {
		compatible = "mediatek,seninf7_mux";
		reg = <0x0 0x1a046000 0x0 0x1000>;
	};

	seninf8_mux@1a047000 {
		compatible = "mediatek,seninf8_mux";
		reg = <0x0 0x1a047000 0x0 0x1000>;
	};

	mipi_rx_config_csi0@1a040000 {
		compatible = "mediatek,mipi_rx_config_csi0";
		reg = <0x0 0x1a040000 0x0 0x1000>;
	};

	mipi_rx_config_csi1@1a041000 {
		compatible = "mediatek,mipi_rx_config_csi1";
		reg = <0x0 0x1a041000 0x0 0x1000>;
	};

	mipi_rx_config_csi2@1a042000 {
		compatible = "mediatek,mipi_rx_config_csi2";
		reg = <0x0 0x1a042000 0x0 0x1000>;
	};

	mipi_rx_config_csi3@1a043000 {
		compatible = "mediatek,mipi_rx_config_csi3";
		reg = <0x0 0x1a043000 0x0 0x1000>;
	};

	mipi_rx_config_csi4@1a044000 {
		compatible = "mediatek,mipi_rx_config_csi4";
		reg = <0x0 0x1a044000 0x0 0x1000>;
	};

	cphy_tx_config@1a040000 {
		compatible = "mediatek,cphy_tx_config";
		reg = <0x0 0x1a040000 0x0 0x1000>;
	};

	scam@1a044000 {
		compatible = "mediatek,scam";
		reg = <0x0 0x1a044000 0x0 0x1000>;
	};

	ccir656@1a044000 {
		compatible = "mediatek,ccir656";
		reg = <0x0 0x1a044000 0x0 0x1000>;
	};

	n3d_ctl_a@1a040000 {
		compatible = "mediatek,n3d_ctl_a";
		reg = <0x0 0x1a040000 0x0 0x1000>;
	};

	n3d_ctl_b@1a041000 {
		compatible = "mediatek,n3d_ctl_b";
		reg = <0x0 0x1a041000 0x0 0x1000>;
	};

	n3d_ctl_c@1a042000 {
		compatible = "mediatek,n3d_ctl_c";
		reg = <0x0 0x1a042000 0x0 0x1000>;
	};

	n3d_ctl_d@1a043000 {
		compatible = "mediatek,n3d_ctl_d";
		reg = <0x0 0x1a043000 0x0 0x1000>;
	};

	ccu@1a0b1000 {
		compatible = "mediatek,ccu";
		reg = <0x0 0x1a0b1000 0x0 0x1000>;
		interrupts = <0x0 0xf8 0x8>;
		clocks = <0x4b 0x9>;
		clock-names = "CCU_CLK_CAM_CCU";
	};

	alc@60000000 {
		compatible = "mediatek,alc";
		reg = <0x0 0x60000000 0x0 0x1000>;
	};

	md_config@80000000 {
		compatible = "mediatek,md_config";
		reg = <0x0 0x80000000 0x0 0x1000>;
	};

	md_uart0@80010000 {
		compatible = "mediatek,md_uart0";
		reg = <0x0 0x80010000 0x0 0x1000>;
	};

	md_p_dma@80020000 {
		compatible = "mediatek,md_p_dma";
		reg = <0x0 0x80020000 0x0 0x1000>;
	};

	md_gpt@80030000 {
		compatible = "mediatek,md_gpt";
		reg = <0x0 0x80030000 0x0 0x1000>;
	};

	simif1@80040000 {
		compatible = "mediatek,simif1";
		reg = <0x0 0x80040000 0x0 0x1000>;
		interrupts = <0x0 0x108 0x8>;
	};

	simif2@80050000 {
		compatible = "mediatek,simif2";
		reg = <0x0 0x80050000 0x0 0x1000>;
		interrupts = <0x0 0x109 0x8>;
	};

	md_peri_misc@80060000 {
		compatible = "mediatek,md_peri_misc";
		reg = <0x0 0x80060000 0x0 0x1000>;
		interrupts = <0x0 0x10b 0x4>;
	};

	md_cirq@f0070000 {
		compatible = "mediatek,md_cirq";
		reg = <0x0 0xf0070000 0x0 0x1000>;
	};

	md_debug1@80080000 {
		compatible = "mediatek,md_debug1";
		reg = <0x0 0x80080000 0x0 0x1000>;
	};

	md_debug2@80090000 {
		compatible = "mediatek,md_debug2";
		reg = <0x0 0x80090000 0x0 0x1000>;
	};

	md_debug3@800a0000 {
		compatible = "mediatek,md_debug3";
		reg = <0x0 0x800a0000 0x0 0x1000>;
	};

	mdpar_dbgmon@800b0000 {
		compatible = "mediatek,mdpar_dbgmon";
		reg = <0x0 0x800b0000 0x0 0x1000>;
	};

	md_peri_clk_ctl@800c0000 {
		compatible = "mediatek,md_peri_clk_ctl";
		reg = <0x0 0x800c0000 0x0 0x1000>;
	};

	md_topsm@f00d0000 {
		compatible = "mediatek,md_topsm";
		reg = <0x0 0xf00d0000 0x0 0x1000>;
	};

	md_ost@f00e0000 {
		compatible = "mediatek,md_ost";
		reg = <0x0 0xf00e0000 0x0 0x1000>;
	};

	md_rgu@f00f0000 {
		compatible = "mediatek,md_rgu";
		reg = <0x0 0xf00f0000 0x0 0x1000>;
	};

	md_i2c@80100000 {
		compatible = "mediatek,md_i2c";
		reg = <0x0 0x80100000 0x0 0x1000>;
	};

	md_eint@80110000 {
		compatible = "mediatek,md_eint";
		reg = <0x0 0x80110000 0x0 0x1000>;
	};

	md_clkctl@80120000 {
		compatible = "mediatek,md_clkctl";
		reg = <0x0 0x80120000 0x0 0x1000>;
	};

	md_global_con_dcm@80130000 {
		compatible = "mediatek,md_global_con_dcm";
		reg = <0x0 0x80130000 0x0 0x1000>;
	};

	md_pll_mixedsys@80140000 {
		compatible = "mediatek,md_pll_mixedsys";
		reg = <0x0 0x80140000 0x0 0x1000>;
	};

	md_clksw@80150000 {
		compatible = "mediatek,md_clksw";
		reg = <0x0 0x80150000 0x0 0x1000>;
	};

	a7_ost@f0160000 {
		compatible = "mediatek,a7_ost";
		reg = <0x0 0xf0160000 0x0 0x1000>;
	};

	md_lite_gpt@80170000 {
		compatible = "mediatek,md_lite_gpt";
		reg = <0x0 0x80170000 0x0 0x1000>;
	};

	md_ps2a7_pccif@80180000 {
		compatible = "mediatek,md_ps2a7_pccif";
		reg = <0x0 0x80180000 0x0 0x1000>;
	};

	md_a72ps_pccif@80190000 {
		compatible = "mediatek,md_a72ps_pccif";
		reg = <0x0 0x80190000 0x0 0x1000>;
	};

	mdperi_mbist_config@801a0000 {
		compatible = "mediatek,mdperi_mbist_config";
		reg = <0x0 0x801a0000 0x0 0x1000>;
	};

	md_sdf_top@801b0000 {
		compatible = "mediatek,md_sdf_top";
		reg = <0x0 0x801b0000 0x0 0x1000>;
	};

	psmcu_misc@80200000 {
		compatible = "mediatek,psmcu_misc";
		reg = <0x0 0x80200000 0x0 0x1000>;
	};

	psmcu_busmon@80210000 {
		compatible = "mediatek,psmcu_busmon";
		reg = <0x0 0x80210000 0x0 0x1000>;
	};

	md_pcm@80220000 {
		compatible = "mediatek,md_pcm";
		reg = <0x0 0x80220000 0x0 0x1000>;
	};

	psmcu_mbist_config@80240000 {
		compatible = "mediatek,psmcu_mbist_config";
		reg = <0x0 0x80240000 0x0 0x1000>;
	};

	md_elm@80250000 {
		compatible = "mediatek,md_elm";
		reg = <0x0 0x80250000 0x0 0x1000>;
	};

	md_abm@80260000 {
		compatible = "mediatek,md_abm";
		reg = <0x0 0x80260000 0x0 0x1000>;
	};

	md_soe@80310000 {
		compatible = "mediatek,md_soe";
		reg = <0x0 0x80310000 0x0 0x1000>;
		interrupts = <0x0 0x10a 0x8>;
	};

	md_infra_busmon@80320000 {
		compatible = "mediatek,md_infra_busmon";
		reg = <0x0 0x80320000 0x0 0x1000>;
	};

	md_uart1@80330000 {
		compatible = "mediatek,md_uart1";
		reg = <0x0 0x80330000 0x0 0x1000>;
	};

	md_uart2@80340000 {
		compatible = "mediatek,md_uart2";
		reg = <0x0 0x80340000 0x0 0x1000>;
	};

	mdinfra_mbist_config@80350000 {
		compatible = "mediatek,mdinfra_mbist_config";
		reg = <0x0 0x80350000 0x0 0x1000>;
	};

	mdsys_mbist_config@80360000 {
		compatible = "mediatek,mdsys_mbist_config";
		reg = <0x0 0x80360000 0x0 0x1000>;
	};

	mdsmicfg@803a0000 {
		compatible = "mediatek,mdsmicfg";
		reg = <0x0 0x803a0000 0x0 0x1000>;
	};

	mdinfra_misc@803b0000 {
		compatible = "mediatek,mdinfra_misc";
		reg = <0x0 0x803b0000 0x0 0x1000>;
	};

	md_bus_recoder@803c0000 {
		compatible = "mediatek,md_bus_recoder";
		reg = <0x0 0x803c0000 0x0 0x1000>;
	};

	md_ppc_top@803d0000 {
		compatible = "mediatek,md_ppc_top";
		reg = <0x0 0x803d0000 0x0 0x1000>;
	};

	a7_wdt@f0400000 {
		compatible = "mediatek,a7_wdt";
		reg = <0x0 0xf0400000 0x0 0x1000>;
	};

	a7_mbist_config@f0410000 {
		compatible = "mediatek,a7_mbist_config";
		reg = <0x0 0xf0410000 0x0 0x1000>;
	};

	a7_cirq@f0420000 {
		compatible = "mediatek,a7_cirq";
		reg = <0x0 0xf0420000 0x0 0x1000>;
	};

	pf_bsi_apb1@80200000 {
		compatible = "mediatek,pf_bsi_apb1";
		reg = <0x0 0x80200000 0x0 0x1000>;
	};

	pf_bsi_apb2@80201000 {
		compatible = "mediatek,pf_bsi_apb2";
		reg = <0x0 0x80201000 0x0 0x1000>;
	};

	rfic1_bsispi@80202000 {
		compatible = "mediatek,rfic1_bsispi";
		reg = <0x0 0x80202000 0x0 0x1000>;
	};

	rfic2_bsispi@80203000 {
		compatible = "mediatek,rfic2_bsispi";
		reg = <0x0 0x80203000 0x0 0x1000>;
	};

	mipi0_bsispi@80205000 {
		compatible = "mediatek,mipi0_bsispi";
		reg = <0x0 0x80205000 0x0 0x1000>;
	};

	mipi1_bsispi@80206000 {
		compatible = "mediatek,mipi1_bsispi";
		reg = <0x0 0x80206000 0x0 0x1000>;
	};

	idc_suart@80207000 {
		compatible = "mediatek,idc_suart";
		reg = <0x0 0x80207000 0x0 0x1000>;
	};

	mdm_psys_misc@8020d000 {
		compatible = "mediatek,mdm_psys_misc";
		reg = <0x0 0x8020d000 0x0 0x1000>;
	};

	mdm_psys_mbistcon@8020e000 {
		compatible = "mediatek,mdm_psys_mbistcon";
		reg = <0x0 0x8020e000 0x0 0x1000>;
	};

	md1_abb_mixedsys@8020c000 {
		compatible = "mediatek,md1_abb_mixedsys";
		reg = <0x0 0x8020c000 0x0 0x1000>;
	};

	md2_abb_mixedsys@8020c000 {
		compatible = "mediatek,md2_abb_mixedsys";
		reg = <0x0 0x8020c000 0x0 0x1000>;
	};

	idma@82000000 {
		compatible = "mediatek,idma";
		reg = <0x0 0x82000000 0x0 0x1000>;
	};

	ahb2dspio@82800000 {
		compatible = "mediatek,ahb2dspio";
		reg = <0x0 0x82800000 0x0 0x1000>;
	};

	md2g_confg@82c00000 {
		compatible = "mediatek,md2g_confg";
		reg = <0x0 0x82c00000 0x0 0x1000>;
	};

	apc@82c30000 {
		compatible = "mediatek,apc";
		reg = <0x0 0x82c30000 0x0 0x1000>;
	};

	csd_acc@82c70000 {
		compatible = "mediatek,csd_acc";
		reg = <0x0 0x82c70000 0x0 0x1000>;
	};

	share_d1@82ca0000 {
		compatible = "mediatek,share_d1";
		reg = <0x0 0x82ca0000 0x0 0x1000>;
	};

	irdma@82cb0000 {
		compatible = "mediatek,irdma";
		reg = <0x0 0x82cb0000 0x0 0x1000>;
	};

	patch@82cc0000 {
		compatible = "mediatek,patch";
		reg = <0x0 0x82cc0000 0x0 0x1000>;
	};

	mdafe@82cd0000 {
		compatible = "mediatek,mdafe";
		reg = <0x0 0x82cd0000 0x0 0x1000>;
	};

	bfe@82ce0000 {
		compatible = "mediatek,bfe";
		reg = <0x0 0x82ce0000 0x0 0x1000>;
	};

	modem_lite_confg@83000000 {
		compatible = "mediatek,modem_lite_confg";
		reg = <0x0 0x83000000 0x0 0x1000>;
	};

	modem_lite_topsm@83010000 {
		compatible = "mediatek,modem_lite_topsm";
		reg = <0x0 0x83010000 0x0 0x1000>;
	};

	tdma@83020000 {
		compatible = "mediatek,tdma";
		reg = <0x0 0x83020000 0x0 0x1000>;
	};

	shreg2@83030000 {
		compatible = "mediatek,shreg2";
		reg = <0x0 0x83030000 0x0 0x1000>;
	};

	divider@83040000 {
		compatible = "mediatek,divider";
		reg = <0x0 0x83040000 0x0 0x1000>;
	};

	fcs@83050000 {
		compatible = "mediatek,fcs";
		reg = <0x0 0x83050000 0x0 0x1000>;
	};

	gcu@83060000 {
		compatible = "mediatek,gcu";
		reg = <0x0 0x83060000 0x0 0x1000>;
	};

	bsi_2g@83070000 {
		compatible = "mediatek,bsi_2g";
		reg = <0x0 0x83070000 0x0 0x1000>;
	};

	bpi_2g@83080000 {
		compatible = "mediatek,bpi_2g";
		reg = <0x0 0x83080000 0x0 0x1000>;
	};

	afc_2g@83090000 {
		compatible = "mediatek,afc_2g";
		reg = <0x0 0x83090000 0x0 0x1000>;
	};

	tdd@84000000 {
		compatible = "mediatek,tdd";
		reg = <0x0 0x84000000 0x0 0x1000>;
	};

	l2ulsbdma@85000000 {
		compatible = "mediatek,l2ulsbdma";
		reg = <0x0 0x85000000 0x0 0x1000>;
	};

	l2ulhbdma@85010000 {
		compatible = "mediatek,l2ulhbdma";
		reg = <0x0 0x85010000 0x0 0x1000>;
	};

	l2dlsbdma@85020000 {
		compatible = "mediatek,l2dlsbdma";
		reg = <0x0 0x85020000 0x0 0x1000>;
	};

	l2dlhbdma@85030000 {
		compatible = "mediatek,l2dlhbdma";
		reg = <0x0 0x85030000 0x0 0x1000>;
	};

	l2mbist@85040000 {
		compatible = "mediatek,l2mbist";
		reg = <0x0 0x85040000 0x0 0x1000>;
	};

	l2pseuphy@85050000 {
		compatible = "mediatek,l2pseuphy";
		reg = <0x0 0x85050000 0x0 0x1000>;
	};

	l2hwlog@85058000 {
		compatible = "mediatek,l2hwlog";
		reg = <0x0 0x85058000 0x0 0x1000>;
	};

	l2soindma@85060000 {
		compatible = "mediatek,l2soindma";
		reg = <0x0 0x85060000 0x0 0x1000>;
	};

	l2sooutdma@85070000 {
		compatible = "mediatek,l2sooutdma";
		reg = <0x0 0x85070000 0x0 0x1000>;
	};

	l2ullmac@85080000 {
		compatible = "mediatek,l2ullmac";
		reg = <0x0 0x85080000 0x0 0x1000>;
	};

	l2dllmac@85090000 {
		compatible = "mediatek,l2dllmac";
		reg = <0x0 0x85090000 0x0 0x1000>;
	};

	l2calmac@85098000 {
		compatible = "mediatek,l2calmac";
		reg = <0x0 0x85098000 0x0 0x1000>;
	};

	l2ulfifomng@850a0000 {
		compatible = "mediatek,l2ulfifomng";
		reg = <0x0 0x850a0000 0x0 0x1000>;
	};

	l2dlfifomng@850a4000 {
		compatible = "mediatek,l2dlfifomng";
		reg = <0x0 0x850a4000 0x0 0x1000>;
	};

	l2sofifomng@850a8000 {
		compatible = "mediatek,l2sofifomng";
		reg = <0x0 0x850a8000 0x0 0x1000>;
	};

	l2sec@850b0000 {
		compatible = "mediatek,l2sec";
		reg = <0x0 0x850b0000 0x0 0x1000>;
	};

	l2ulsecctl@850b4000 {
		compatible = "mediatek,l2ulsecctl";
		reg = <0x0 0x850b4000 0x0 0x1000>;
	};

	l2dlsecctl@850b8000 {
		compatible = "mediatek,l2dlsecctl";
		reg = <0x0 0x850b8000 0x0 0x1000>;
	};

	l2sosecctl@850bc000 {
		compatible = "mediatek,l2sosecctl";
		reg = <0x0 0x850bc000 0x0 0x1000>;
	};

	l2misc@850c0000 {
		compatible = "mediatek,l2misc";
		reg = <0x0 0x850c0000 0x0 0x1000>;
	};

	l2ulbuf@850e0000 {
		compatible = "mediatek,l2ulbuf";
		reg = <0x0 0x850e0000 0x0 0x1000>;
	};

	l2dlbuf@850f0000 {
		compatible = "mediatek,l2dlbuf";
		reg = <0x0 0x850f0000 0x0 0x1000>;
	};

	mdl1ao@f60f0000 {
		compatible = "mediatek,mdl1ao";
		reg = <0x0 0xf60f0000 0x0 0x1000>;
	};

	modem_confg@87000000 {
		compatible = "mediatek,modem_confg";
		reg = <0x0 0x87000000 0x0 0x1000>;
	};

	modem_topsm@87010000 {
		compatible = "mediatek,modem_topsm";
		reg = <0x0 0x87010000 0x0 0x1000>;
	};

	bsi_3g@87070000 {
		compatible = "mediatek,bsi_3g";
		reg = <0x0 0x87070000 0x0 0x1000>;
	};

	bpi_3g@87080000 {
		compatible = "mediatek,bpi_3g";
		reg = <0x0 0x87080000 0x0 0x1000>;
	};

	afc_3g@87090000 {
		compatible = "mediatek,afc_3g";
		reg = <0x0 0x87090000 0x0 0x1000>;
	};

	wcdma_timer@870a0000 {
		compatible = "mediatek,wcdma_timer";
		reg = <0x0 0x870a0000 0x0 0x1000>;
	};

	dpa_bc@870b0000 {
		compatible = "mediatek,dpa_bc";
		reg = <0x0 0x870b0000 0x0 0x1000>;
	};

	pfc_encode@870c0000 {
		compatible = "mediatek,pfc_encode";
		reg = <0x0 0x870c0000 0x0 0x1000>;
	};

	pfc_decode@870d0000 {
		compatible = "mediatek,pfc_decode";
		reg = <0x0 0x870d0000 0x0 0x1000>;
	};

	hspasys_1_confg@87200000 {
		compatible = "mediatek,hspasys_1_confg";
		reg = <0x0 0x87200000 0x0 0x1000>;
	};

	hseq@87210000 {
		compatible = "mediatek,hseq";
		reg = <0x0 0x87210000 0x0 0x1000>;
	};

	hsce@87220000 {
		compatible = "mediatek,hsce";
		reg = <0x0 0x87220000 0x0 0x1000>;
	};

	hspasys_1_mbist@87230000 {
		compatible = "mediatek,hspasys_1_mbist";
		reg = <0x0 0x87230000 0x0 0x1000>;
	};

	hspasys_2_confg@87400000 {
		compatible = "mediatek,hspasys_2_confg";
		reg = <0x0 0x87400000 0x0 0x1000>;
	};

	hseq_dc@87410000 {
		compatible = "mediatek,hseq_dc";
		reg = <0x0 0x87410000 0x0 0x1000>;
	};

	hsce_dc@87420000 {
		compatible = "mediatek,hsce_dc";
		reg = <0x0 0x87420000 0x0 0x1000>;
	};

	rake_dc@87430000 {
		compatible = "mediatek,rake_dc";
		reg = <0x0 0x87430000 0x0 0x1000>;
	};

	hspasys_2_mbist@87440000 {
		compatible = "mediatek,hspasys_2_mbist";
		reg = <0x0 0x87440000 0x0 0x1000>;
	};

	uea_uia_u0@87600000 {
		compatible = "mediatek,uea_uia_u0";
		reg = <0x0 0x87600000 0x0 0x1000>;
	};

	uea_uia_u1@87610000 {
		compatible = "mediatek,uea_uia_u1";
		reg = <0x0 0x87610000 0x0 0x1000>;
	};

	dpa_rlc@87620000 {
		compatible = "mediatek,dpa_rlc";
		reg = <0x0 0x87620000 0x0 0x1000>;
	};

	dpa_mac@87630000 {
		compatible = "mediatek,dpa_mac";
		reg = <0x0 0x87630000 0x0 0x1000>;
	};

	upa@f0920000 {
		compatible = "mediatek,upa";
		reg = <0x0 0xf0920000 0x0 0x1000>;
	};

	h_rxbrp@87650000 {
		compatible = "mediatek,h_rxbrp";
		reg = <0x0 0x87650000 0x0 0x1000>;
	};

	rxbrp@87660000 {
		compatible = "mediatek,rxbrp";
		reg = <0x0 0x87660000 0x0 0x1000>;
	};

	hspasys_3_confg@f0910000 {
		compatible = "mediatek,hspasys_3_confg";
		reg = <0x0 0xf0910000 0x0 0x1000>;
	};

	txbrp@87680000 {
		compatible = "mediatek,txbrp";
		reg = <0x0 0x87680000 0x0 0x1000>;
	};

	txcrp@87690000 {
		compatible = "mediatek,txcrp";
		reg = <0x0 0x87690000 0x0 0x1000>;
	};

	h_txbrp@876a0000 {
		compatible = "mediatek,h_txbrp";
		reg = <0x0 0x876a0000 0x0 0x1000>;
	};

	txupc@876b0000 {
		compatible = "mediatek,txupc";
		reg = <0x0 0x876b0000 0x0 0x1000>;
	};

	bc@876c0000 {
		compatible = "mediatek,bc";
		reg = <0x0 0x876c0000 0x0 0x1000>;
	};

	dbg_tx@876d0000 {
		compatible = "mediatek,dbg_tx";
		reg = <0x0 0x876d0000 0x0 0x1000>;
	};

	hspasys_3_mbist@876e0000 {
		compatible = "mediatek,hspasys_3_mbist";
		reg = <0x0 0x876e0000 0x0 0x1000>;
	};

	rxsrp@87800000 {
		compatible = "mediatek,rxsrp";
		reg = <0x0 0x87800000 0x0 0x1000>;
	};

	indec@87810000 {
		compatible = "mediatek,indec";
		reg = <0x0 0x87810000 0x0 0x1000>;
	};

	rake_0@87820000 {
		compatible = "mediatek,rake_0";
		reg = <0x0 0x87820000 0x0 0x1000>;
	};

	rake_1@87830000 {
		compatible = "mediatek,rake_1";
		reg = <0x0 0x87830000 0x0 0x1000>;
	};

	rake_2@87840000 {
		compatible = "mediatek,rake_2";
		reg = <0x0 0x87840000 0x0 0x1000>;
	};

	searcher@87850000 {
		compatible = "mediatek,searcher";
		reg = <0x0 0x87850000 0x0 0x1000>;
	};

	rxdfe@87860000 {
		compatible = "mediatek,rxdfe";
		reg = <0x0 0x87860000 0x0 0x1000>;
	};

	hspasys_4_confg@87870000 {
		compatible = "mediatek,hspasys_4_confg";
		reg = <0x0 0x87870000 0x0 0x1000>;
	};

	dbg@87880000 {
		compatible = "mediatek,dbg";
		reg = <0x0 0x87880000 0x0 0x1000>;
	};

	dwrap0@87890000 {
		compatible = "mediatek,dwrap0";
		reg = <0x0 0x87890000 0x0 0x1000>;
	};

	log3g@878a0000 {
		compatible = "mediatek,log3g";
		reg = <0x0 0x878a0000 0x0 0x1000>;
	};

	hspasys_4_mbist@878b0000 {
		compatible = "mediatek,hspasys_4_mbist";
		reg = <0x0 0x878b0000 0x0 0x1000>;
	};

	dwrap1@878c0000 {
		compatible = "mediatek,dwrap1";
		reg = <0x0 0x878c0000 0x0 0x1000>;
	};

	c2ksys@38000000 {
		compatible = "mediatek,c2ksys";
		reg = <0x0 0x38000000 0x0 0x1000>;
	};

	c2k_rccif_ps_c2k@a0211000 {
		compatible = "mediatek,c2k_rccif_ps_c2k";
		reg = <0x0 0xa0211000 0x0 0x1000>;
	};

	c2k_rccif_l1_c2k@a0211400 {
		compatible = "mediatek,c2k_rccif_l1_c2k";
		reg = <0x0 0xa0211400 0x0 0x1000>;
	};

	c2k_md2md_pccif_md1@a0211800 {
		compatible = "mediatek,c2k_md2md_pccif_md1";
		reg = <0x0 0xa0211800 0x0 0x1000>;
	};

	c2k_rccif_c2k_ps@a0213000 {
		compatible = "mediatek,c2k_rccif_c2k_ps";
		reg = <0x0 0xa0213000 0x0 0x1000>;
	};

	c2k_rccif_c2k_l1@a0213400 {
		compatible = "mediatek,c2k_rccif_c2k_l1";
		reg = <0x0 0xa0213400 0x0 0x1000>;
	};

	c2k_md2md_pccif_md2@a0213800 {
		compatible = "mediatek,c2k_md2md_pccif_md2";
		reg = <0x0 0xa0213800 0x0 0x1000>;
	};

	c2k_ccif1@a020c000 {
		compatible = "mediatek,c2k_ccif1";
		reg = <0x0 0xa020c000 0x0 0x1000>;
	};

	mt_soc_btcvsd_rx_pcm {
		compatible = "mediatek,mt_soc_btcvsd_rx_pcm";
	};

	mt_soc_btcvsd_tx_pcm {
		compatible = "mediatek,mt_soc_btcvsd_tx_pcm";
	};

	mt_soc_deep_buffer_dl_pcm {
		compatible = "mediatek,mt_soc_pcm_deep_buffer_dl";
	};

	mt_soc_ul1_pcm {
		compatible = "mediatek,mt_soc_pcm_capture";
	};

	mt_soc_voice_md1 {
		compatible = "mediatek,mt_soc_pcm_voice_md1";
	};

	mt_soc_hdmi_pcm {
		compatible = "mediatek,mt_soc_pcm_hdmi";
	};

	mt_soc_uldlloopback_pcm {
		compatible = "mediatek,mt_soc_pcm_uldlloopback";
	};

	mt_soc_i2s0_pcm {
		compatible = "mediatek,mt_soc_pcm_dl1_i2s0";
	};

	mt_soc_mrgrx_pcm {
		compatible = "mediatek,mt_soc_pcm_mrgrx";
	};

	mt_soc_mrgrx_awb_pcm {
		compatible = "mediatek,mt_soc_pcm_mrgrx_awb";
	};

	mt_soc_fm_i2s_pcm {
		compatible = "mediatek,mt_soc_pcm_fm_i2s";
	};

	mt_soc_fm_i2s_awb_pcm {
		compatible = "mediatek,mt_soc_pcm_fm_i2s_awb";
	};

	mt_soc_i2s0dl1_pcm {
		compatible = "mediatek,mt_soc_pcm_dl1_i2s0dl1";
	};

	mt_soc_dl1_awb_pcm {
		compatible = "mediatek,mt_soc_pcm_dl1_awb";
	};

	mt_soc_voice_md1_bt {
		compatible = "mediatek,mt_soc_pcm_voice_md1_bt";
	};

	mt_soc_voip_bt_out {
		compatible = "mediatek,mt_soc_pcm_dl1_bt";
	};

	mt_soc_voip_bt_in {
		compatible = "mediatek,mt_soc_pcm_bt_dai";
	};

	mt_soc_tdmrx_pcm {
		compatible = "mediatek,mt_soc_tdm_capture";
	};

	mt_soc_fm_mrgtx_pcm {
		compatible = "mediatek,mt_soc_pcm_fmtx";
	};

	mt_soc_ul2_pcm {
		compatible = "mediatek,mt_soc_pcm_capture2";
	};

	mt_soc_i2s0_awb_pcm {
		compatible = "mediatek,mt_soc_pcm_i2s0_awb";
	};

	mt_soc_voice_md2 {
		compatible = "mediatek,mt_soc_pcm_voice_md2";
	};

	mt_soc_routing_pcm {
		compatible = "mediatek,mt_soc_pcm_routing";
	};

	mt_soc_voice_md2_bt {
		compatible = "mediatek,mt_soc_pcm_voice_md2_bt";
	};

	mt_soc_hp_impedance_pcm {
		compatible = "mediatek,mt_soc_pcm_hp_impedance";
	};

	mt_soc_codec_name {
		compatible = "mediatek,mt_soc_codec_63xx";
		use_hp_depop_flow = <0x0>;
		use_ul_260k = <0x0>;
	};

	mt_soc_dummy_pcm {
		compatible = "mediatek,mt_soc_pcm_dummy";
	};

	mt_soc_codec_dummy_name {
		compatible = "mediatek,mt_soc_codec_dummy";
	};

	mt_soc_routing_dai_name {
		compatible = "mediatek,mt_soc_dai_routing";
	};

	mt_soc_dai_name {
		compatible = "mediatek,mt_soc_dai_stub";
	};

	mt_soc_dl2_pcm {
		compatible = "mediatek,mt_soc_pcm_dl2";
	};

	mt_soc_anc_pcm {
		compatible = "mediatek,mt_soc_pcm_anc";
	};

	mt_soc_pcm_voice_ultra {
		compatible = "mediatek,mt_soc_pcm_voice_ultra";
	};

	mt_soc_pcm_voice_usb {
		compatible = "mediatek,mt_soc_pcm_voice_usb";
	};

	mt_soc_pcm_voice_usb_echoref {
		compatible = "mediatek,mt_soc_pcm_voice_usb_echoref";
	};

	consys@18070000 {
		compatible = "mediatek,mt6763-consys";
		#address-cells = <0x2>;
		#size-cells = <0x2>;
		reg = <0x0 0x18070000 0x0 0x200 0x0 0x10007000 0x0 0x100 0x0 0x10000000 0x0 0x2000 0x0 0x10006000 0x0 0x1000>;
		interrupts = <0x0 0x10d 0x8 0x0 0x10f 0x2>;
		clocks = <0x2e 0x2>;
		clock-names = "conn";
		linux,phandle = <0x83>;
		phandle = <0x83>;
	};

	wifi@180f0000 {
		compatible = "mediatek,wifi";
		reg = <0x0 0x180f0000 0x0 0x5c>;
		interrupts = <0x0 0x10e 0x8>;
		clocks = <0x5 0x2b>;
		clock-names = "wifi-dma";
	};

	btcvsd@10001000 {
		compatible = "mediatek,audio_bt_cvsd";
		offset = <0xf00 0x800 0xfd0 0xfd4 0xfd8>;
		reg = <0x0 0x10001000 0x0 0x1000 0x0 0x18000000 0x0 0x10000 0x0 0x18080000 0x0 0x8000>;
		interrupts = <0x0 0x10c 0x8>;
	};

	irtx_pwm {
		compatible = "mediatek,irtx-pwm";
		pwm_ch = <0x1>;
		pwm_data_invert = <0x0>;
		linux,phandle = <0x84>;
		phandle = <0x84>;
	};

	battery {
		compatible = "mediatek,bat_gm30";
		DIFFERENCE_FULLOCV_ITH = <0xc8>;
		SHUTDOWN_1_TIME = <0xa>;
		KEEP_100_PERCENT = <0x1>;
		R_FG_VALUE = <0xa>;
		EMBEDDED_SEL = <0x1>;
		PMIC_SHUTDOWN_CURRENT = <0x14>;
		FG_METER_RESISTANCE = <0x4b>;
		CAR_TUNE_VALUE = <0x5d>;
		PMIC_MIN_VOL = <0x82dc>;
		POWERON_SYSTEM_IBOOT = <0x1f4>;
		SHUTDOWN_GAUGE0_VOLTAGE = <0x84d0>;
		TEMPERATURE_T0 = <0x32>;
		TEMPERATURE_T1 = <0x19>;
		TEMPERATURE_T2 = <0xa>;
		TEMPERATURE_T3 = <0x0>;
		TEMPERATURE_T4 = <0xfffffff6>;
		g_FG_PSEUDO100_T0 = <0x64>;
		g_FG_PSEUDO100_T1 = <0x64>;
		g_FG_PSEUDO100_T2 = <0x64>;
		g_FG_PSEUDO100_T3 = <0x64>;
		g_FG_PSEUDO100_T4 = <0x64>;
		Q_MAX_SYS_VOLTAGE_BAT0 = <0xd48>;
		Q_MAX_SYS_VOLTAGE_BAT1 = <0xd48>;
		Q_MAX_SYS_VOLTAGE_BAT2 = <0xd48>;
		Q_MAX_SYS_VOLTAGE_BAT3 = <0xd48>;
		battery0_profile_t0_num = <0x64>;
		battery0_profile_t0 = <0x0 0xab54 0x0 0x1b5 0xaadc 0x3f8 0x369 0xaa64 0x745 0x51e 0xa9ec 0x73f 0x6d2 0xa976 0x73c 0x887 0xa903 0x743 0xa3b 0xa88e 0x747 0xbf0 0xa816 0x747 0xda5 0xa79e 0x747 0xf59 0xa726 0x747 0x110e 0xa6b2 0x74c 0x12c2 0xa63f 0x753 0x1477 0xa5c7 0x74c 0x162b 0xa550 0x748 0x17e0 0xa4de 0x74e 0x1994 0xa46b 0x755 0x1b49 0xa3f8 0x75c 0x1cfe 0xa386 0x760 0x1eb2 0xa313 0x760 0x2067 0xa2a4 0x764 0x221b 0xa237 0x76b 0x23d0 0xa1ca 0x772 0x2584 0xa15d 0x779 0x2739 0xa0f0 0x779 0x28ee 0xa083 0x779 0x2aa2 0xa015 0x779 0x2c57 0x9fac 0x77b 0x2e0b 0x9f4a 0x782 0x2fc0 0x9ef1 0x78c 0x3174 0x9ea0 0x799 0x3329 0x9e35 0x791 0x34de 0x9dbd 0x77c 0x3692 0x9d3c 0x773 0x3847 0x9cb9 0x76c 0x39fb 0x9c5c 0x77a 0x3bb0 0x9c03 0x787 0x3d64 0x9bbc 0x795 0x3f19 0x9b6e 0x797 0x40cd 0x9b11 0x783 0x4282 0x9aaf 0x76e 0x4437 0x9a47 0x75a 0x45eb 0x99dc 0x73c 0x47a0 0x996f 0x71a 0x4954 0x9906 0x6fe 0x4b09 0x989e 0x6e3 0x4cbd 0x9847 0x6d5 0x4e72 0x97f0 0x6c7 0x5027 0x979f 0x6ba 0x51db 0x9752 0x6b1 0x5390 0x9711 0x6b1 0x5544 0x96d5 0x6b4 0x56f9 0x969e 0x6bb 0x58ad 0x9668 0x6bd 0x5a62 0x9631 0x6bd 0x5c17 0x95ff 0x6c3 0x5dcb 0x95ce 0x6ca 0x5f80 0x95a2 0x6d7 0x6134 0x9577 0x6e4 0x62e9 0x954b 0x6ea 0x649d 0x9521 0x6f1 0x6652 0x94fb 0x6f8 0x6807 0x94d5 0x6ff 0x69bb 0x94af 0x706 0x6b70 0x948c 0x70d 0x6d24 0x946b 0x713 0x6ed9 0x944a 0x71a 0x708d 0x942a 0x721 0x7242 0x940f 0x728 0x73f6 0x93f2 0x72e 0x75ab 0x93d2 0x72e 0x7760 0x93b1 0x72e 0x7914 0x9390 0x72e 0x7ac9 0x936f 0x72e 0x7c7d 0x934f 0x72e 0x7e32 0x932a 0x729 0x7fe6 0x9304 0x722 0x819b 0x92d9 0x71b 0x8350 0x92ae 0x715 0x8504 0x9287 0x715 0x86b9 0x9263 0x717 0x886d 0x9248 0x725 0x8a22 0x9227 0x730 0x8bd6 0x91fb 0x737 0x8d8b 0x91c7 0x736 0x8f40 0x918b 0x730 0x90f4 0x9153 0x737 0x92a9 0x911d 0x744 0x945d 0x90d5 0x73b 0x9612 0x9088 0x72e 0x97c6 0x9062 0x734 0x997b 0x9040 0x73d 0x9b2f 0x9035 0x752 0x9ce4 0x9029 0x76d 0x9e99 0x9018 0x796 0xa04d 0x8ff5 0x7cc 0xa202 0x8fbe 0x811 0xa3b6 0x8ec7 0x808 0xa56b 0x8d70 0x7d8 0xa71f 0x8b2c 0x7fd 0xa8d4 0x88b8 0x834>;
		battery0_profile_t1_num = <0x64>;
		battery0_profile_t1 = <0x0 0xab54 0x0 0x1b5 0xaadc 0x3f8 0x369 0xaa64 0x745 0x51e 0xa9ec 0x73f 0x6d2 0xa976 0x73c 0x887 0xa903 0x743 0xa3b 0xa88e 0x747 0xbf0 0xa816 0x747 0xda5 0xa79e 0x747 0xf59 0xa726 0x747 0x110e 0xa6b2 0x74c 0x12c2 0xa63f 0x753 0x1477 0xa5c7 0x74c 0x162b 0xa550 0x748 0x17e0 0xa4de 0x74e 0x1994 0xa46b 0x755 0x1b49 0xa3f8 0x75c 0x1cfe 0xa386 0x760 0x1eb2 0xa313 0x760 0x2067 0xa2a4 0x764 0x221b 0xa237 0x76b 0x23d0 0xa1ca 0x772 0x2584 0xa15d 0x779 0x2739 0xa0f0 0x779 0x28ee 0xa083 0x779 0x2aa2 0xa015 0x779 0x2c57 0x9fac 0x77b 0x2e0b 0x9f4a 0x782 0x2fc0 0x9ef1 0x78c 0x3174 0x9ea0 0x799 0x3329 0x9e35 0x791 0x34de 0x9dbd 0x77c 0x3692 0x9d3c 0x773 0x3847 0x9cb9 0x76c 0x39fb 0x9c5c 0x77a 0x3bb0 0x9c03 0x787 0x3d64 0x9bbc 0x795 0x3f19 0x9b6e 0x797 0x40cd 0x9b11 0x783 0x4282 0x9aaf 0x76e 0x4437 0x9a47 0x75a 0x45eb 0x99dc 0x73c 0x47a0 0x996f 0x71a 0x4954 0x9906 0x6fe 0x4b09 0x989e 0x6e3 0x4cbd 0x9847 0x6d5 0x4e72 0x97f0 0x6c7 0x5027 0x979f 0x6ba 0x51db 0x9752 0x6b1 0x5390 0x9711 0x6b1 0x5544 0x96d5 0x6b4 0x56f9 0x969e 0x6bb 0x58ad 0x9668 0x6bd 0x5a62 0x9631 0x6bd 0x5c17 0x95ff 0x6c3 0x5dcb 0x95ce 0x6ca 0x5f80 0x95a2 0x6d7 0x6134 0x9577 0x6e4 0x62e9 0x954b 0x6ea 0x649d 0x9521 0x6f1 0x6652 0x94fb 0x6f8 0x6807 0x94d5 0x6ff 0x69bb 0x94af 0x706 0x6b70 0x948c 0x70d 0x6d24 0x946b 0x713 0x6ed9 0x944a 0x71a 0x708d 0x942a 0x721 0x7242 0x940f 0x728 0x73f6 0x93f2 0x72e 0x75ab 0x93d2 0x72e 0x7760 0x93b1 0x72e 0x7914 0x9390 0x72e 0x7ac9 0x936f 0x72e 0x7c7d 0x934f 0x72e 0x7e32 0x932a 0x729 0x7fe6 0x9304 0x722 0x819b 0x92d9 0x71b 0x8350 0x92ae 0x715 0x8504 0x9287 0x715 0x86b9 0x9263 0x717 0x886d 0x9248 0x725 0x8a22 0x9227 0x730 0x8bd6 0x91fb 0x737 0x8d8b 0x91c7 0x736 0x8f40 0x918b 0x730 0x90f4 0x9153 0x737 0x92a9 0x911d 0x744 0x945d 0x90d5 0x73b 0x9612 0x9088 0x72e 0x97c6 0x9062 0x734 0x997b 0x9040 0x73d 0x9b2f 0x9035 0x752 0x9ce4 0x9029 0x76d 0x9e99 0x9018 0x796 0xa04d 0x8ff5 0x7cc 0xa202 0x8fbe 0x811 0xa3b6 0x8ec7 0x808 0xa56b 0x8d70 0x7d8 0xa71f 0x8b2c 0x7fd 0xa8d4 0x88b8 0x834>;
		battery0_profile_t2_num = <0x64>;
		battery0_profile_t2 = <0x0 0xab54 0x0 0x1b5 0xaadc 0x3f8 0x369 0xaa64 0x745 0x51e 0xa9ec 0x73f 0x6d2 0xa976 0x73c 0x887 0xa903 0x743 0xa3b 0xa88e 0x747 0xbf0 0xa816 0x747 0xda5 0xa79e 0x747 0xf59 0xa726 0x747 0x110e 0xa6b2 0x74c 0x12c2 0xa63f 0x753 0x1477 0xa5c7 0x74c 0x162b 0xa550 0x748 0x17e0 0xa4de 0x74e 0x1994 0xa46b 0x755 0x1b49 0xa3f8 0x75c 0x1cfe 0xa386 0x760 0x1eb2 0xa313 0x760 0x2067 0xa2a4 0x764 0x221b 0xa237 0x76b 0x23d0 0xa1ca 0x772 0x2584 0xa15d 0x779 0x2739 0xa0f0 0x779 0x28ee 0xa083 0x779 0x2aa2 0xa015 0x779 0x2c57 0x9fac 0x77b 0x2e0b 0x9f4a 0x782 0x2fc0 0x9ef1 0x78c 0x3174 0x9ea0 0x799 0x3329 0x9e35 0x791 0x34de 0x9dbd 0x77c 0x3692 0x9d3c 0x773 0x3847 0x9cb9 0x76c 0x39fb 0x9c5c 0x77a 0x3bb0 0x9c03 0x787 0x3d64 0x9bbc 0x795 0x3f19 0x9b6e 0x797 0x40cd 0x9b11 0x783 0x4282 0x9aaf 0x76e 0x4437 0x9a47 0x75a 0x45eb 0x99dc 0x73c 0x47a0 0x996f 0x71a 0x4954 0x9906 0x6fe 0x4b09 0x989e 0x6e3 0x4cbd 0x9847 0x6d5 0x4e72 0x97f0 0x6c7 0x5027 0x979f 0x6ba 0x51db 0x9752 0x6b1 0x5390 0x9711 0x6b1 0x5544 0x96d5 0x6b4 0x56f9 0x969e 0x6bb 0x58ad 0x9668 0x6bd 0x5a62 0x9631 0x6bd 0x5c17 0x95ff 0x6c3 0x5dcb 0x95ce 0x6ca 0x5f80 0x95a2 0x6d7 0x6134 0x9577 0x6e4 0x62e9 0x954b 0x6ea 0x649d 0x9521 0x6f1 0x6652 0x94fb 0x6f8 0x6807 0x94d5 0x6ff 0x69bb 0x94af 0x706 0x6b70 0x948c 0x70d 0x6d24 0x946b 0x713 0x6ed9 0x944a 0x71a 0x708d 0x942a 0x721 0x7242 0x940f 0x728 0x73f6 0x93f2 0x72e 0x75ab 0x93d2 0x72e 0x7760 0x93b1 0x72e 0x7914 0x9390 0x72e 0x7ac9 0x936f 0x72e 0x7c7d 0x934f 0x72e 0x7e32 0x932a 0x729 0x7fe6 0x9304 0x722 0x819b 0x92d9 0x71b 0x8350 0x92ae 0x715 0x8504 0x9287 0x715 0x86b9 0x9263 0x717 0x886d 0x9248 0x725 0x8a22 0x9227 0x730 0x8bd6 0x91fb 0x737 0x8d8b 0x91c7 0x736 0x8f40 0x918b 0x730 0x90f4 0x9153 0x737 0x92a9 0x911d 0x744 0x945d 0x90d5 0x73b 0x9612 0x9088 0x72e 0x97c6 0x9062 0x734 0x997b 0x9040 0x73d 0x9b2f 0x9035 0x752 0x9ce4 0x9029 0x76d 0x9e99 0x9018 0x796 0xa04d 0x8ff5 0x7cc 0xa202 0x8fbe 0x811 0xa3b6 0x8ec7 0x808 0xa56b 0x8d70 0x7d8 0xa71f 0x8b2c 0x7fd 0xa8d4 0x88b8 0x834>;
		battery0_profile_t3_num = <0x64>;
		battery0_profile_t3 = <0x0 0xaa14 0x1478 0x1b5 0xa96e 0x1478 0x369 0xa8d7 0x15cf 0x51e 0xa84f 0x1761 0x6d2 0xa7cc 0x183c 0x887 0xa74d 0x1880 0xa3b 0xa6d3 0x1893 0xbf0 0xa659 0x1857 0xda5 0xa5e8 0x1860 0xf59 0xa56e 0x17f9 0x110e 0xa4fb 0x17e1 0x12c2 0xa483 0x17cc 0x1477 0xa40e 0x17a3 0x162b 0xa3a0 0x1768 0x17e0 0xa335 0x174d 0x1994 0xa2c3 0x176d 0x1b49 0xa252 0x158c 0x1cfe 0xa1e9 0x146e 0x1eb2 0xa180 0x13df 0x2067 0xa111 0x1412 0x221b 0xa0a0 0x145e 0x23d0 0xa032 0x1496 0x2584 0x9fcb 0x14ee 0x2739 0x9f6d 0x1505 0x28ee 0x9f28 0x14a5 0x2aa2 0x9ed9 0x14b9 0x2c57 0x9e68 0x14b7 0x2e0b 0x9dcb 0x1492 0x2fc0 0x9d1c 0x143e 0x3174 0x9c77 0x141c 0x3329 0x9be9 0x1466 0x34de 0x9b70 0x1442 0x3692 0x9b07 0x140e 0x3847 0x9aaf 0x13fa 0x39fb 0x9a57 0x13e8 0x3bb0 0x9a00 0x1452 0x3d64 0x99a0 0x1575 0x3f19 0x993d 0x167a 0x40cd 0x98e6 0x1665 0x4282 0x988f 0x1647 0x4437 0x9841 0x1672 0x45eb 0x97f2 0x159e 0x47a0 0x97aa 0x15a4 0x4954 0x976a 0x160e 0x4b09 0x972d 0x164e 0x4cbd 0x96f0 0x1642 0x4e72 0x96b3 0x162d 0x5027 0x9676 0x164e 0x51db 0x9641 0x1645 0x5390 0x960d 0x16c1 0x5544 0x95df 0x16f8 0x56f9 0x95ae 0x16f7 0x58ad 0x957e 0x1722 0x5a62 0x9552 0x174c 0x5c17 0x9528 0x1704 0x5dcb 0x9505 0x1785 0x5f80 0x94d9 0x179f 0x6134 0x94b5 0x17c8 0x62e9 0x9492 0x17e7 0x649d 0x946f 0x1812 0x6652 0x944c 0x179b 0x6807 0x942c 0x1715 0x69bb 0x9410 0x17f2 0x6b70 0x93ed 0x1861 0x6d24 0x93ca 0x1872 0x6ed9 0x93b7 0x16da 0x708d 0x939f 0x1737 0x7242 0x9384 0x180f 0x73f6 0x9372 0x1767 0x75ab 0x9364 0x16eb 0x7760 0x934a 0x1a3b 0x7914 0x9330 0x1c4b 0x7ac9 0x930d 0x1d1d 0x7c7d 0x92ea 0x1ab3 0x7e32 0x92c7 0x19b3 0x7fe6 0x929f 0x1991 0x819b 0x9273 0x19b2 0x8350 0x9247 0x1a0c 0x8504 0x921b 0x1a64 0x86b9 0x91e6 0x1a90 0x886d 0x91a9 0x1acd 0x8a22 0x916c 0x1b5c 0x8bd6 0x9129 0x1bc8 0x8d8b 0x90e8 0x1c06 0x8f40 0x90b5 0x1c69 0x90f4 0x9095 0x1d46 0x92a9 0x907b 0x1ed8 0x945d 0x9061 0x21d9 0x9612 0x903e 0x23f2 0x97c6 0x9005 0x258b 0x997b 0x8f9e 0x27ad 0x9b2f 0x8edc 0x2994 0x9ce4 0x8d99 0x2b21 0x9e99 0x8bbb 0x2d13 0xa04d 0x8934 0x2f49 0xa202 0x8660 0x2af8 0xa3b6 0x8660 0x2af8 0xa56b 0x8660 0x2af8 0xa71f 0x8660 0x2af8 0xa8d4 0x8660 0x2af8>;
		battery0_profile_t4_num = <0x64>;
		battery0_profile_t4 = <0x0 0xaa1e 0x2c2e 0x1b5 0xa93b 0x2c2e 0x369 0xa885 0x2cb4 0x51e 0xa7e3 0x2d01 0x6d2 0xa74f 0x2d19 0x887 0xa6c3 0x2d0f 0xa3b 0xa63a 0x2ce5 0xbf0 0xa5b7 0x2ca6 0xda5 0xa534 0x2c57 0xf59 0xa4ba 0x2c1a 0x110e 0xa440 0x2bdd 0x12c2 0xa3cb 0x2b94 0x1477 0xa35a 0x2b45 0x162b 0xa2e5 0x2b01 0x17e0 0xa26d 0x2ac6 0x1994 0xa1fb 0x2a78 0x1b49 0xa18a 0x2a32 0x1cfe 0xa118 0x29e4 0x1eb2 0xa0a7 0x298e 0x2067 0xa041 0x294f 0x221b 0x9fe1 0x2928 0x23d0 0x9f81 0x2907 0x2584 0x9f1d 0x28d5 0x2739 0x9ea9 0x288b 0x28ee 0x9e1d 0x2810 0x2aa2 0x9d79 0x277d 0x2c57 0x9cd3 0x26f0 0x2e0b 0x9c33 0x2675 0x2fc0 0x9ba3 0x261a 0x3174 0x9b26 0x25e8 0x3329 0x9ab9 0x25da 0x34de 0x9a5a 0x25db 0x3692 0x9a0b 0x25e3 0x3847 0x99bd 0x25cc 0x39fb 0x9975 0x25b1 0x3bb0 0x992a 0x2592 0x3d64 0x98ec 0x253f 0x3f19 0x98b1 0x24ea 0x40cd 0x985c 0x24e5 0x4282 0x980d 0x24cb 0x4437 0x97bf 0x24b9 0x45eb 0x9778 0x24a0 0x47a0 0x9732 0x24a7 0x4954 0x96ec 0x24ae 0x4b09 0x96ab 0x24bb 0x4cbd 0x9671 0x24d8 0x4e72 0x963b 0x24f6 0x5027 0x95fe 0x24ff 0x51db 0x95c9 0x2510 0x5390 0x959d 0x251a 0x5544 0x956b 0x2529 0x56f9 0x953c 0x253b 0x58ad 0x9510 0x254c 0x5a62 0x94e7 0x2558 0x5c17 0x94c3 0x255c 0x5dcb 0x9497 0x2577 0x5f80 0x9474 0x2591 0x6134 0x9459 0x25ab 0x62e9 0x9438 0x25c5 0x649d 0x9420 0x25e5 0x6652 0x940a 0x260f 0x6807 0x93f0 0x2641 0x69bb 0x93d7 0x266e 0x6b70 0x93c6 0x26a3 0x6d24 0x93ac 0x26e8 0x6ed9 0x9399 0x273d 0x708d 0x9381 0x2782 0x7242 0x936c 0x27d3 0x73f6 0x9357 0x282c 0x75ab 0x933d 0x2882 0x7760 0x9322 0x28ef 0x7914 0x9308 0x297b 0x7ac9 0x92e5 0x2a29 0x7c7d 0x92ca 0x2aa4 0x7e32 0x92a3 0x2b22 0x7fe6 0x927d 0x2bae 0x819b 0x9256 0x2c43 0x8350 0x922a 0x2cd7 0x8504 0x91fe 0x2d6e 0x86b9 0x91c9 0x2e14 0x886d 0x9195 0x2ec2 0x8a22 0x9161 0x2fab 0x8bd6 0x912c 0x30ab 0x8d8b 0x90f8 0x31d2 0x8f40 0x90c7 0x3318 0x90f4 0x909b 0x3475 0x92a9 0x9070 0x360f 0x945d 0x9044 0x37ef 0x9612 0x9008 0x39f1 0x97c6 0x8fb5 0x3c09 0x997b 0x8f35 0x3e15 0x9b2f 0x8e80 0x3edf 0x9ce4 0x8d76 0x3cb7 0x9e99 0x8bec 0x38e0 0xa04d 0x8bec 0x38e0 0xa202 0x8bec 0x38e0 0xa3b6 0x8bec 0x38e0 0xa56b 0x8bec 0x38e0 0xa71f 0x8bec 0x38e0 0xa8d4 0x8bec 0x38e0>;
		linux,phandle = <0x85>;
		phandle = <0x85>;
	};

	mt_charger {
		compatible = "mediatek,mt-charger";
		linux,phandle = <0x86>;
		phandle = <0x86>;
	};

	charger {
		compatible = "mediatek,charger";
		algorithm_name = "SwitchCharging";
		battery_cv = <0x432380>;
		max_charger_voltage = <0x632ea0>;
		min_charger_voltage = <0x4630c0>;
		usb_charger_current_suspend = <0x0>;
		usb_charger_current_unconfigured = <0x11170>;
		usb_charger_current_configured = <0x7a120>;
		usb_charger_current = <0x7a120>;
		ac_charger_current = <0x2191c0>;
		ac_charger_input_current = <0x1e8480>;
		non_std_ac_charger_current = <0x7a120>;
		charging_host_charger_current = <0x16e360>;
		apple_1_0a_charger_current = <0x9eb10>;
		apple_2_1a_charger_current = <0xc3500>;
		ta_ac_charger_current = <0x2dc6c0>;
		jeita_temp_above_t4_cv_voltage = <0x40b280>;
		jeita_temp_t3_to_t4_cv_voltage = <0x40b280>;
		jeita_temp_t2_to_t3_cv_voltage = <0x423920>;
		jeita_temp_t1_to_t2_cv_voltage = <0x40b280>;
		jeita_temp_t0_to_t1_cv_voltage = <0x3da540>;
		jeita_temp_below_t0_cv_voltage = <0x3da540>;
		temp_t4_threshold = <0x32>;
		temp_t4_thres_minus_x_degree = <0x2f>;
		temp_t3_threshold = <0x2d>;
		temp_t3_thres_minus_x_degree = <0x27>;
		temp_t2_threshold = <0xa>;
		temp_t2_thres_plus_x_degree = <0x10>;
		temp_t1_threshold = <0x0>;
		temp_t1_thres_plus_x_degree = <0x6>;
		temp_t0_threshold = <0x0>;
		temp_t0_thres_plus_x_degree = <0x0>;
		temp_neg_10_threshold = <0x0>;
		enable_min_charge_temperature;
		min_charge_temperature = <0x0>;
		min_charge_temperature_plus_x_degree = <0x6>;
		max_charge_temperature = <0x37>;
		max_charge_temperature_minus_x_degree = <0x2f>;
		pe20_ichg_level_threshold = <0x3e8>;
		ta_start_battery_soc = <0x0>;
		ta_stop_battery_soc = <0x55>;
		chg1_ta_ac_charger_current = <0x16e360>;
		chg2_ta_ac_charger_current = <0x16e360>;
		cable_imp_threshold = <0x2bb>;
		vbat_cable_imp_threshold = <0xf3c>;
		bif_threshold1 = <0x40d990>;
		bif_threshold2 = <0x419ce0>;
		bif_cv_under_threshold2 = <0x43e6d0>;
		linux,phandle = <0x87>;
		phandle = <0x87>;
	};

	sim2_hot_plug {
		linux,phandle = <0x88>;
		phandle = <0x88>;
	};

	sim1_hot_plug {
		linux,phandle = <0x89>;
		phandle = <0x89>;
	};

	fingerprint {
		compatible = "mediatek,goodix-fp";
		linux,phandle = <0x8a>;
		phandle = <0x8a>;
	};

	otg_iddig {
		compatible = "mediatek,usb_iddig_bi_eint";
		linux,phandle = <0x8b>;
		phandle = <0x8b>;
	};

	rt9465_slave_chr {
		compatible = "richtek,rt9465";
		linux,phandle = <0x8c>;
		phandle = <0x8c>;
	};

	mrdump_ext_rst {
		compatible = "mediatek, mrdump-disable";
		source = "EINT";
		mode = "IRQ";
		status = "okay";
		linux,phandle = <0x8d>;
		phandle = <0x8d>;
	};

	rt-pd-manager {
		compatible = "mediatek,rt-pd-manager";
	};

	pmic_clock_buffer_ctrl {
		compatible = "mediatek,pmic_clock_buffer";
		mediatek,clkbuf-quantity = <0x7>;
		mediatek,clkbuf-config = <0x2 0x1 0x1 0x2 0x0 0x0 0x1>;
		mediatek,clkbuf-driving-current = <0xffffffff 0xffffffff 0xffffffff 0xffffffff 0xffffffff 0xffffffff 0xffffffff>;
		linux,phandle = <0x8e>;
		phandle = <0x8e>;
	};

	smart_pa {
		linux,phandle = <0x8f>;
		phandle = <0x8f>;
	};

	mt6311_pmic {
		linux,phandle = <0x90>;
		phandle = <0x90>;
	};

	firmware {

		android {
			compatible = "android,firmware";

			fstab {
				compatible = "android,fstab";

				vendor {
					compatible = "android,vendor";
					dev = "/dev/block/platform/bootdevice/by-name/vendor";
					type = "ext4";
					mnt_flags = "ro";
					fsmgr_flags = "wait,verify";
				};
			};
		};
	};

	odm {
		compatible = "simple-bus";
		linux,phandle = <0x91>;
		phandle = <0x91>;
	};

	lcm_power_gpio {
		compatible = "prize,lcm_power_gpio";
		linux,phandle = <0x92>;
		phandle = <0x92>;
	};

	typec_accdet {
		compatible = "prize,typec_accdet";
		linux,phandle = <0x93>;
		phandle = <0x93>;
	};

	gsensor {
		compatible = "mediatek,gsensor";
		linux,phandle = <0x94>;
		phandle = <0x94>;
	};

	fpc_fingerprint {
		compatible = "mediatek,mt6765-fpc";
		linux,phandle = <0x95>;
		phandle = <0x95>;
	};

	flashlight_aw3641_gpio {
		compatible = "mediatek,flashlights_aw3641_gpio";
		linux,phandle = <0x96>;
		phandle = <0x96>;
	};

	flashlight_wd3100d_gpio {
		compatible = "mediatek,flashlights_wd3100d_gpio";
		linux,phandle = <0x97>;
		phandle = <0x97>;
	};

	flashlight_isink {
		compatible = "mediatek,flashlights_isink";
		linux,phandle = <0x98>;
		phandle = <0x98>;
	};

	mt_pmic_regulator {
		compatible = "mediatek,mt_pmic";

		buck_regulators {
			compatible = "mediatek,mt_pmic_buck_regulators";

			buck_vs1 {
				regulator-name = "vs1";
				regulator-min-microvolt = <0x124f80>;
				regulator-max-microvolt = <0x2a88ac>;
				regulator-ramp-delay = <0x30d4>;
				regulator-enable-ramp-delay = <0x3e8>;
				linux,phandle = <0x99>;
				phandle = <0x99>;
			};

			buck_vmodem {
				regulator-name = "vmodem";
				regulator-min-microvolt = <0x7a120>;
				regulator-max-microvolt = <0x13bdb6>;
				regulator-ramp-delay = <0x186a>;
				regulator-enable-ramp-delay = <0x3e8>;
				linux,phandle = <0x9a>;
				phandle = <0x9a>;
			};

			buck_vcore {
				regulator-name = "vcore";
				regulator-min-microvolt = <0x7a120>;
				regulator-max-microvolt = <0x13bdb6>;
				regulator-ramp-delay = <0x186a>;
				regulator-enable-ramp-delay = <0x3e8>;
				linux,phandle = <0x9b>;
				phandle = <0x9b>;
			};

			buck_vproc {
				regulator-name = "vproc";
				regulator-min-microvolt = <0x7a120>;
				regulator-max-microvolt = <0x13bdb6>;
				regulator-ramp-delay = <0x186a>;
				regulator-enable-ramp-delay = <0x3e8>;
				linux,phandle = <0x9c>;
				phandle = <0x9c>;
			};

			buck_vs2 {
				regulator-name = "vs2";
				regulator-min-microvolt = <0x124f80>;
				regulator-max-microvolt = <0x2a88ac>;
				regulator-ramp-delay = <0x30d4>;
				regulator-enable-ramp-delay = <0x3e8>;
				linux,phandle = <0x9d>;
				phandle = <0x9d>;
			};

			buck_vpa {
				regulator-name = "vpa";
				regulator-min-microvolt = <0x7a120>;
				regulator-max-microvolt = <0x37b1d0>;
				regulator-ramp-delay = <0xc350>;
				regulator-enable-ramp-delay = <0x3e8>;
				linux,phandle = <0x9e>;
				phandle = <0x9e>;
			};
		};

		ldo_regulators {
			compatible = "mediatek,mt_pmic_ldo_regulators";

			ldo_vsim1 {
				regulator-name = "vsim1";
				regulator-min-microvolt = <0x19f0a0>;
				regulator-max-microvolt = <0x2f4d60>;
				regulator-enable-ramp-delay = <0x108>;
				linux,phandle = <0x9f>;
				phandle = <0x9f>;
			};

			ldo_vibr {
				regulator-name = "vibr";
				regulator-min-microvolt = <0x124f80>;
				regulator-max-microvolt = <0x325aa0>;
				regulator-enable-ramp-delay = <0x6e>;
				linux,phandle = <0xa0>;
				phandle = <0xa0>;
			};

			ldo_vrf12 {
				compatible = "regulator-fixed";
				regulator-name = "vrf12";
				regulator-min-microvolt = <0x124f80>;
				regulator-max-microvolt = <0x124f80>;
				regulator-enable-ramp-delay = <0xdc>;
				linux,phandle = <0xa1>;
				phandle = <0xa1>;
			};

			ldo_vusb {
				compatible = "regulator-fixed";
				regulator-name = "vusb";
				regulator-min-microvolt = <0x2dc6c0>;
				regulator-max-microvolt = <0x2dc6c0>;
				regulator-enable-ramp-delay = <0x108>;
				linux,phandle = <0xa2>;
				phandle = <0xa2>;
			};

			ldo_vcamio {
				compatible = "regulator-fixed";
				regulator-name = "vcamio";
				regulator-min-microvolt = <0x1b7740>;
				regulator-max-microvolt = <0x1b7740>;
				regulator-enable-ramp-delay = <0x108>;
				linux,phandle = <0xa3>;
				phandle = <0xa3>;
			};

			ldo_vcama {
				regulator-name = "vcama";
				regulator-min-microvolt = <0x2625a0>;
				regulator-max-microvolt = <0x2ab980>;
				regulator-enable-ramp-delay = <0x108>;
				linux,phandle = <0xa4>;
				phandle = <0xa4>;
			};

			ldo_vcamd {
				regulator-name = "vcamd";
				regulator-min-microvolt = <0xf4240>;
				regulator-max-microvolt = <0x1b7740>;
				regulator-enable-ramp-delay = <0x108>;
				linux,phandle = <0xa5>;
				phandle = <0xa5>;
			};

			ldo_vcn18 {
				compatible = "regulator-fixed";
				regulator-name = "vcn18";
				regulator-min-microvolt = <0x1b7740>;
				regulator-max-microvolt = <0x1b7740>;
				regulator-enable-ramp-delay = <0x108>;
				linux,phandle = <0xa6>;
				phandle = <0xa6>;
			};

			ldo_vfe28 {
				compatible = "regulator-fixed";
				regulator-name = "vfe28";
				regulator-min-microvolt = <0x2ab980>;
				regulator-max-microvolt = <0x2ab980>;
				regulator-enable-ramp-delay = <0x6e>;
				linux,phandle = <0xa7>;
				phandle = <0xa7>;
			};

			ldo_vaux18 {
				compatible = "regulator-fixed";
				regulator-name = "vaux18";
				regulator-min-microvolt = <0x1b7740>;
				regulator-max-microvolt = <0x1b7740>;
				regulator-enable-ramp-delay = <0x108>;
				linux,phandle = <0xa8>;
				phandle = <0xa8>;
			};

			ldo_vmipi {
				regulator-name = "vmipi";
				regulator-min-microvolt = <0x19f0a0>;
				regulator-max-microvolt = <0x1b7740>;
				regulator-enable-ramp-delay = <0x108>;
				linux,phandle = <0xa9>;
				phandle = <0xa9>;
			};

			ldo_vcn28 {
				compatible = "regulator-fixed";
				regulator-name = "vcn28";
				regulator-min-microvolt = <0x2ab980>;
				regulator-max-microvolt = <0x2ab980>;
				regulator-enable-ramp-delay = <0x108>;
				linux,phandle = <0xaa>;
				phandle = <0xaa>;
			};

			ldo_vsram_others {
				regulator-name = "vsram_others";
				regulator-min-microvolt = <0x7a120>;
				regulator-max-microvolt = <0x13bdb6>;
				regulator-ramp-delay = <0x186a>;
				regulator-enable-ramp-delay = <0x6e>;
				linux,phandle = <0xab>;
				phandle = <0xab>;
			};

			ldo_vsram_gpu {
				regulator-name = "vsram_gpu";
				regulator-min-microvolt = <0x7a120>;
				regulator-max-microvolt = <0x13bdb6>;
				regulator-ramp-delay = <0x186a>;
				regulator-enable-ramp-delay = <0x6e>;
				linux,phandle = <0xac>;
				phandle = <0xac>;
			};

			ldo_vsram_proc {
				regulator-name = "vsram_proc";
				regulator-min-microvolt = <0x7a120>;
				regulator-max-microvolt = <0x13bdb6>;
				regulator-ramp-delay = <0x186a>;
				regulator-enable-ramp-delay = <0x6e>;
				linux,phandle = <0xad>;
				phandle = <0xad>;
			};

			ldo_vxo22 {
				regulator-name = "vxo22";
				regulator-min-microvolt = <0x2191c0>;
				regulator-max-microvolt = <0x249f00>;
				regulator-enable-ramp-delay = <0x6e>;
				linux,phandle = <0xae>;
				phandle = <0xae>;
			};

			ldo_vmch {
				regulator-name = "vmch";
				regulator-min-microvolt = <0x2c4020>;
				regulator-max-microvolt = <0x325aa0>;
				regulator-enable-ramp-delay = <0x24>;
				linux,phandle = <0xc>;
				phandle = <0xc>;
			};

			ldo_vemc {
				regulator-name = "vemc";
				regulator-min-microvolt = <0x2c4020>;
				regulator-max-microvolt = <0x325aa0>;
				regulator-enable-ramp-delay = <0x108>;
				linux,phandle = <0x4>;
				phandle = <0x4>;
			};

			ldo_vio28 {
				compatible = "regulator-fixed";
				regulator-name = "vio28";
				regulator-min-microvolt = <0x2ab980>;
				regulator-max-microvolt = <0x2ab980>;
				regulator-enable-ramp-delay = <0x108>;
				linux,phandle = <0xaf>;
				phandle = <0xaf>;
			};

			ldo_va12 {
				compatible = "regulator-fixed";
				regulator-name = "va12";
				regulator-min-microvolt = <0x124f80>;
				regulator-max-microvolt = <0x124f80>;
				regulator-enable-ramp-delay = <0x108>;
				linux,phandle = <0xb0>;
				phandle = <0xb0>;
			};

			ldo_vio18 {
				compatible = "regulator-fixed";
				regulator-name = "vio18";
				regulator-min-microvolt = <0x1b7740>;
				regulator-max-microvolt = <0x1b7740>;
				regulator-enable-ramp-delay = <0x108>;
				linux,phandle = <0xb1>;
				phandle = <0xb1>;
			};

			ldo_vrf18 {
				compatible = "regulator-fixed";
				regulator-name = "vrf18";
				regulator-min-microvolt = <0x1b9e50>;
				regulator-max-microvolt = <0x1b9e50>;
				regulator-enable-ramp-delay = <0xdc>;
				linux,phandle = <0xb2>;
				phandle = <0xb2>;
			};

			ldo_vcn33_bt {
				regulator-name = "vcn33_bt";
				regulator-min-microvolt = <0x325aa0>;
				regulator-max-microvolt = <0x3567e0>;
				regulator-enable-ramp-delay = <0x108>;
				linux,phandle = <0xb3>;
				phandle = <0xb3>;
			};

			ldo_vcn33_wifi {
				regulator-name = "vcn33_wifi";
				regulator-min-microvolt = <0x325aa0>;
				regulator-max-microvolt = <0x3567e0>;
				regulator-enable-ramp-delay = <0x108>;
				linux,phandle = <0xb4>;
				phandle = <0xb4>;
			};

			ldo_vbif28 {
				compatible = "regulator-fixed";
				regulator-name = "vbif28";
				regulator-min-microvolt = <0x2ab980>;
				regulator-max-microvolt = <0x2ab980>;
				regulator-enable-ramp-delay = <0x108>;
				linux,phandle = <0xb5>;
				phandle = <0xb5>;
			};

			ldo_vmc {
				regulator-name = "vmc";
				regulator-min-microvolt = <0x1c61a0>;
				regulator-max-microvolt = <0x325aa0>;
				regulator-enable-ramp-delay = <0x24>;
				linux,phandle = <0xd>;
				phandle = <0xd>;
			};

			ldo_vdram {
				regulator-name = "vdram";
				regulator-min-microvolt = <0x10c8e0>;
				regulator-max-microvolt = <0x124f80>;
				regulator-enable-ramp-delay = <0x108>;
				linux,phandle = <0xb6>;
				phandle = <0xb6>;
			};

			ldo_vldo28 {
				regulator-name = "vldo28";
				regulator-min-microvolt = <0x2ab980>;
				regulator-max-microvolt = <0x2dc6c0>;
				regulator-enable-ramp-delay = <0x108>;
				linux,phandle = <0xb7>;
				phandle = <0xb7>;
			};

			ldo_vaud28 {
				compatible = "regulator-fixed";
				regulator-name = "vaud28";
				regulator-min-microvolt = <0x2ab980>;
				regulator-max-microvolt = <0x2ab980>;
				regulator-enable-ramp-delay = <0x108>;
				linux,phandle = <0xb8>;
				phandle = <0xb8>;
			};

			ldo_vsim2 {
				regulator-name = "vsim2";
				regulator-min-microvolt = <0x19f0a0>;
				regulator-max-microvolt = <0x2f4d60>;
				regulator-enable-ramp-delay = <0x108>;
				linux,phandle = <0xb9>;
				phandle = <0xb9>;
			};
		};
	};

	__symbols__ {
		chosen = "/chosen";
		msdc0 = "/msdc@11230000";
		msdc1 = "/msdc@11240000";
		msdc2 = "/msdc@11250000";
		msdc1_ins = "/msdc1_ins@0";
		cpu0 = "/cpus/cpu@000";
		cpu1 = "/cpus/cpu@001";
		cpu2 = "/cpus/cpu@002";
		cpu3 = "/cpus/cpu@003";
		cpu4 = "/cpus/cpu@100";
		cpu5 = "/cpus/cpu@101";
		cpu6 = "/cpus/cpu@102";
		cpu7 = "/cpus/cpu@103";
		LEGACY_MCDI = "/cpus/idle-states/legacy-mcdi";
		LEGACY_SODI = "/cpus/idle-states/legacy-sodi";
		LEGACY_SODI3 = "/cpus/idle-states/legacy-sodi3";
		LEGACY_DPIDLE = "/cpus/idle-states/legacy-dpidle";
		LEGACY_SUSPEND = "/cpus/idle-states/legacy-suspend";
		MCDI_CPU = "/cpus/idle-states/mcdi-cpu";
		MCDI_CLUSTER = "/cpus/idle-states/mcdi-cluster";
		SODI = "/cpus/idle-states/sodi";
		SODI3 = "/cpus/idle-states/sodi3";
		DPIDLE = "/cpus/idle-states/dpidle";
		SUSPEND = "/cpus/idle-states/suspend";
		memory = "/memory";
		cpu_dbgapb = "/cpu_dbgapb";
		reserved_memory = "/reserved-memory";
		gic = "/interrupt-controller@40001000";
		clk_null = "/clocks/clk_null";
		clk26m = "/clocks/clk26m";
		clk32k = "/clocks/clk32k";
		dramc_sram_debug = "/dramc_sram_debug@0011d800";
		topckgen = "/topckgen@10000000";
		infracfg_ao = "/infracfg_ao@10001000";
		scpsys = "/scpsys@10001000";
		syscfg_pctl_lt = "/syscfg_pctl_lt@11f20000";
		syscfg_pctl_lm = "/syscfg_pctl_lm@11e80000";
		syscfg_pctl_lb = "/syscfg_pctl_lb@11e70000";
		syscfg_pctl_bl = "/syscfg_pctl_bl@11e90000";
		syscfg_pctl_rb = "/syscfg_pctl_rb@11d30000";
		syscfg_pctl_rm = "/syscfg_pctl_rm@11d20000";
		syscfg_pctl_rt = "/syscfg_pctl_rt@11c50000";
		syscfg_pctl_tl = "/syscfg_pctl_tl@11f30000";
		cpuxgpt = "/cpuxgpt@10200000";
		timer = "/timer";
		gpio_usage_mapping = "/gpio";
		gpio = "/gpio@10005000";
		syscfg_pctl_a = "/syscfg_pctl_a@10005000";
		pio = "/pinctrl@10005000";
		ufshci_pins_state_va09_on = "/pinctrl@10005000/ufshci_va09on";
		ufshci_pins_state_va09_off = "/pinctrl@10005000/ufshci_va09off";
		iommu = "/pinctrl@10005000/m4u@0";
		msdc0_pins_default = "/pinctrl@10005000/msdc0@default";
		msdc0_register_setting_default = "/pinctrl@10005000/msdc0@register_default";
		msdc1_pins_default = "/pinctrl@10005000/msdc1@default";
		msdc1_pins_sdr104 = "/pinctrl@10005000/msdc1@sdr104";
		msdc1_pins_sdr50 = "/pinctrl@10005000/msdc1@sdr50";
		msdc1_pins_ddr50 = "/pinctrl@10005000/msdc1@ddr50";
		msdc1_register_setting_default = "/pinctrl@10005000/msdc1@register_default";
		msdc2_pins_default = "/pinctrl@10005000/msdc2@default";
		msdc2_register_setting_default = "/pinctrl@10005000/msdc2@register_default";
		eintc = "/eintc@1000b000";
		apmixed = "/apmixed@1000c000";
		main_pmic = "/pwrap@1000d000/pmic_irq";
		keypad = "/kp@10010000";
		mdcldma = "/mdcldma@10014000";
		apuart0 = "/apuart0@11002000";
		apuart1 = "/apuart1@11003000";
		auxadc = "/auxadc@11001000";
		i2c0 = "/i2c@11007000";
		i2c1 = "/i2c@11014000";
		i2c2 = "/i2c@11015000";
		i2c5 = "/i2c@1100f000";
		i2c3 = "/i2c@11011000";
		i2c4 = "/i2c@11017000";
		i2c6 = "/i2c@11005000";
		i2c7 = "/i2c@11008000";
		i2c8 = "/i2c@11009000";
		i2c9 = "/i2c@11016000";
		spi0 = "/spi@1100a000";
		spi1 = "/spi@11010000";
		spi2 = "/spi@11012000";
		spi3 = "/spi@11013000";
		spi4 = "/spi@11018000";
		spi5 = "/spi@11019000";
		audio = "/audio@11220000";
		audgpio = "/mt_soc_dl1_pcm@11220000";
		ufshci = "/ufshci@11270000";
		mfgcfg = "/mfgcfg@13000000";
		mmsys_config = "/mmsys_config@14000000";
		nfc = "/nfc";
		flashlight_core = "/flashlight_core";
		irq_nfc = "/irq_nfc";
		mtkfb = "/mtkfb@0";
		als = "/als_ps@0";
		mse = "/mse";
		gyro = "/gyro";
		touch = "/touch";
		accdet = "/accdet";
		dispsys = "/dispsys@14000000";
		dsi_te = "/dsi_te";
		dsi_te_1 = "/dsi_te_1";
		mhl = "/mhl@0";
		eint_hdmi_hpd = "/eint_hdmi_hpd@0";
		mdp_rdma0 = "/mdp_rdma0@14001000";
		mdp_rdma1 = "/mdp_rdma1@14002000";
		mdp_rsz0 = "/mdp_rsz0@14003000";
		mdp_rsz1 = "/mdp_rsz1@14004000";
		mdp_wrot0 = "/mdp_wrot0@14005000";
		mdp_wdma = "/mdp_wdma@14006000";
		mdp_tdshp = "/mdp_tdshp@14007000";
		disp_ovl0 = "/disp_ovl0@14008000";
		disp_ovl0_2l = "/disp_ovl0_2l@14009000";
		disp_ovl1_2l = "/disp_ovl1_2l@1400a000";
		disp_color0 = "/disp_color0@1400e000";
		disp_aal0 = "/disp_aal0@14010000";
		disp_mutex = "/disp_mutex@14016000";
		smi_larb0 = "/smi_larb0@14017000";
		venc_gcon = "/venc_gcon@17000000";
		smi_larb3 = "/smi_larb3@17010000";
		venc = "/venc@17020000";
		imgsys = "/imgsys@15020000";
		smi_larb1 = "/smi_larb1@15021000";
		camsys = "/camsys@1a000000";
		smi_larb2 = "/smi_larb2@1a001000";
		kd_camera_hw1 = "/kd_camera_hw1@1a040000";
		kd_camera_hw2 = "/kd_camera_hw2@1a040000";
		consys = "/consys@18070000";
		irtx_pwm = "/irtx_pwm";
		bat_gm30 = "/battery";
		mt_charger = "/mt_charger";
		charger = "/charger";
		sim2_hot_plug = "/sim2_hot_plug";
		sim1_hot_plug = "/sim1_hot_plug";
		goodix_fp = "/fingerprint";
		otg_iddig = "/otg_iddig";
		rt9465_slave_chr = "/rt9465_slave_chr";
		mrdump_ext_rst = "/mrdump_ext_rst";
		pmic_clock_buffer_ctrl = "/pmic_clock_buffer_ctrl";
		smart_pa = "/smart_pa";
		mt6311_pmic = "/mt6311_pmic";
		odm = "/odm";
		lcm_power_gpio = "/lcm_power_gpio";
		typec_accdet = "/typec_accdet";
		gsensor = "/gsensor";
		fpc = "/fpc_fingerprint";
		flashlights_aw3641_gpio = "/flashlight_aw3641_gpio";
		flashlights_wd3100d_gpio = "/flashlight_wd3100d_gpio";
		flashlights_isink = "/flashlight_isink";
		mt_pmic_vs1_buck_reg = "/mt_pmic_regulator/buck_regulators/buck_vs1";
		mt_pmic_vmodem_buck_reg = "/mt_pmic_regulator/buck_regulators/buck_vmodem";
		mt_pmic_vcore_buck_reg = "/mt_pmic_regulator/buck_regulators/buck_vcore";
		mt_pmic_vproc_buck_reg = "/mt_pmic_regulator/buck_regulators/buck_vproc";
		mt_pmic_vs2_buck_reg = "/mt_pmic_regulator/buck_regulators/buck_vs2";
		mt_pmic_vpa_buck_reg = "/mt_pmic_regulator/buck_regulators/buck_vpa";
		mt_pmic_vsim1_ldo_reg = "/mt_pmic_regulator/ldo_regulators/ldo_vsim1";
		mt_pmic_vibr_ldo_reg = "/mt_pmic_regulator/ldo_regulators/ldo_vibr";
		mt_pmic_vrf12_ldo_reg = "/mt_pmic_regulator/ldo_regulators/ldo_vrf12";
		mt_pmic_vusb_ldo_reg = "/mt_pmic_regulator/ldo_regulators/ldo_vusb";
		mt_pmic_vcamio_ldo_reg = "/mt_pmic_regulator/ldo_regulators/ldo_vcamio";
		mt_pmic_vcama_ldo_reg = "/mt_pmic_regulator/ldo_regulators/ldo_vcama";
		mt_pmic_vcamd_ldo_reg = "/mt_pmic_regulator/ldo_regulators/ldo_vcamd";
		mt_pmic_vcn18_ldo_reg = "/mt_pmic_regulator/ldo_regulators/ldo_vcn18";
		mt_pmic_vfe28_ldo_reg = "/mt_pmic_regulator/ldo_regulators/ldo_vfe28";
		mt_pmic_vaux18_ldo_reg = "/mt_pmic_regulator/ldo_regulators/ldo_vaux18";
		mt_pmic_vmipi_ldo_reg = "/mt_pmic_regulator/ldo_regulators/ldo_vmipi";
		mt_pmic_vcn28_ldo_reg = "/mt_pmic_regulator/ldo_regulators/ldo_vcn28";
		mt_pmic_vsram_others_ldo_reg = "/mt_pmic_regulator/ldo_regulators/ldo_vsram_others";
		mt_pmic_vsram_gpu_ldo_reg = "/mt_pmic_regulator/ldo_regulators/ldo_vsram_gpu";
		mt_pmic_vsram_proc_ldo_reg = "/mt_pmic_regulator/ldo_regulators/ldo_vsram_proc";
		mt_pmic_vxo22_ldo_reg = "/mt_pmic_regulator/ldo_regulators/ldo_vxo22";
		mt_pmic_vmch_ldo_reg = "/mt_pmic_regulator/ldo_regulators/ldo_vmch";
		mt_pmic_vemc_ldo_reg = "/mt_pmic_regulator/ldo_regulators/ldo_vemc";
		mt_pmic_vio28_ldo_reg = "/mt_pmic_regulator/ldo_regulators/ldo_vio28";
		mt_pmic_va12_ldo_reg = "/mt_pmic_regulator/ldo_regulators/ldo_va12";
		mt_pmic_vio18_ldo_reg = "/mt_pmic_regulator/ldo_regulators/ldo_vio18";
		mt_pmic_vrf18_ldo_reg = "/mt_pmic_regulator/ldo_regulators/ldo_vrf18";
		mt_pmic_vcn33_bt_ldo_reg = "/mt_pmic_regulator/ldo_regulators/ldo_vcn33_bt";
		mt_pmic_vcn33_wifi_ldo_reg = "/mt_pmic_regulator/ldo_regulators/ldo_vcn33_wifi";
		mt_pmic_vbif28_ldo_reg = "/mt_pmic_regulator/ldo_regulators/ldo_vbif28";
		mt_pmic_vmc_ldo_reg = "/mt_pmic_regulator/ldo_regulators/ldo_vmc";
		mt_pmic_vdram_ldo_reg = "/mt_pmic_regulator/ldo_regulators/ldo_vdram";
		mt_pmic_vldo28_ldo_reg = "/mt_pmic_regulator/ldo_regulators/ldo_vldo28";
		mt_pmic_vaud28_ldo_reg = "/mt_pmic_regulator/ldo_regulators/ldo_vaud28";
		mt_pmic_vsim2_ldo_reg = "/mt_pmic_regulator/ldo_regulators/ldo_vsim2";
	};
};
